## drivers/gpu/drm/samsung/panel_decon/s6e8fc3/Kconfig
```kconfig
menuconfig EXYNOS_DECON_LCD_S6E8FC3
	tristate "S6E8FC3 DDI Panel Driver"
	depends on MCD_PANEL
	default n
	help
		This enables S6E8FC3 DDI dependent panel drivers of
		common panel driver. say Y, if you have a panel based on
		the S6E8FC3 DDI.
```

## drivers/gpu/drm/samsung/panel_decon/tft_common/Kconfig
```kconfig
menuconfig EXYNOS_DECON_LCD_TFT_COMMON
	tristate "TFT_COMMON DDI Panel Driver"
	depends on MCD_PANEL
	default n
	help
		This enables TFT_COMMON DDI dependent panel drivers of
		common panel driver. say Y, if you have a panel based on
		the TFT_COMMON DDI.

menuconfig EXYNOS_DECON_LCD_TFT_M33
	tristate "TFT_M33 DDI Panel Driver"
	depends on EXYNOS_DECON_LCD_TFT_COMMON
	default n
	help
		This enables TFT_M33 DDI dependent panel drivers of
		common panel driver. say Y, if you have a panel based on
		the TFT_M33 DDI.

menuconfig EXYNOS_DECON_LCD_TFT_GTS8L
	tristate "TFT_GTS8L DDI Panel Driver"
	depends on EXYNOS_DECON_LCD_TFT_COMMON
	default n
	help
		This enables TFT_GTS8L DDI dependent panel drivers of
		common panel driver. say Y, if you have a panel based on
		the TFT_GTS8L DDI.

menuconfig EXYNOS_DECON_LCD_TFT_A14X
	tristate "TFT_A14X DDI Panel Driver"
	depends on EXYNOS_DECON_LCD_TFT_COMMON
	default n
	help
		This enables TFT_A14X DDI dependent panel drivers of
		common panel driver. say Y, if you have a panel based on
		the TFT_A14 DDI.

menuconfig EXYNOS_DECON_LCD_TFT_M14X
	tristate "TFT_M14X DDI Panel Driver"
	depends on EXYNOS_DECON_LCD_TFT_COMMON
	default n
	help
		This enables TFT_M14X DDI dependent panel drivers of
		common panel driver. say Y, if you have a panel based on
		the TFT_M14 DDI.

menuconfig EXYNOS_DECON_LCD_TFT_BIRDIEP
	tristate "TFT_BIRDIEP DDI Panel Driver"
	depends on EXYNOS_DECON_LCD_TFT_COMMON
	default n
	help
		This enables TFT_BIRDIEP DDI dependent panel drivers of
		common panel driver. say Y, if you have a panel based on
		the TFT_BIRDIEP DDI.
```

## drivers/gpu/drm/samsung/sgpu/Kconfig
```kconfig
# SPDX-License-Identifier: MIT
config DRM_SGPU
	tristate "Samsung GPU"
	depends on DRM && MMU
	select FW_LOADER
        select DRM_KMS_HELPER
	select DRM_SCHED
        select DRM_TTM
	select POWER_SUPPLY
	select HWMON
	select BACKLIGHT_CLASS_DEVICE
	select INTERVAL_TREE
	select CHASH
	select TRACE_GPU_MEM
	help
	  Choose this option if you have a recent SGPU.

	  If M is selected, the module will be called sgpu.

config DRM_SGPU_BUILTIN_FIRMWARE
	bool "Enable use of built-in firmware"
	depends on DRM_SGPU
	default y
	help
	  Selecting this option enables linking firmware binaries into the driver.

config DRM_SGPU_EXYNOS
	bool "Enable Exynos related code"
	depends on DRM_SGPU
	default n
	help
	  This option is for SGPU in Eynos.

config DRM_AMDGPU_SI
	bool "Enable amdgpu support for SI parts"
	depends on DRM_SGPU
	help
	  Choose this option if you want to enable experimental support
	  for SI asics.

	  SI is already supported in radeon. Experimental support for SI
	  in amdgpu will be disabled by default and is still provided by
	  radeon. Use module options to override this:

	  radeon.si_support=0 amdgpu.si_support=1

config DRM_AMDGPU_CIK
	bool "Enable amdgpu support for CIK parts"
	depends on DRM_SGPU
	help
	  Choose this option if you want to enable support for CIK asics.

	  CIK is already supported in radeon. Support for CIK in amdgpu
	  will be disabled by default and is still provided by radeon.
	  Use module options to override this:

	  radeon.cik_support=0 amdgpu.cik_support=1

config DRM_AMDGPU_USERPTR
	bool "Always enable userptr write support"
	depends on DRM_SGPU
	depends on MMU
	select HMM_MIRROR
	select MMU_NOTIFIER
	help
	  This option selects CONFIG_HMM and CONFIG_HMM_MIRROR if it
	  isn't already selected to enabled full userptr support.

config DRM_AMDGPU_GART_DEBUGFS
	bool "Allow GART access through debugfs"
	depends on DRM_SGPU
	depends on DEBUG_FS
	default n
	help
	  Selecting this option creates a debugfs file to inspect the mapped
	  pages. Uses more memory for housekeeping, enable only for debugging.

config DRM_AMDGPU_DUMP
	bool "Enable AMDGPU GPU dump upon GPU hang"
	depends on DRM_SGPU
	depends on DRM_DUMP
	default y
	help
	  Selecting this option enables support for persisting AMDGPU's
	  different blocks register status upon GPU hang.

config DRM_AMDGPU_GMC_DUMP
	bool "Persist GMC block's status"
	depends on DRM_AMDGPU_DUMP
	default y
	help
	  Selecting this option enables support for persisting
	  AMDGPU's GMC block register status upon GPU hang.

config DRM_AMDGPU_GFX_DUMP
	bool "Persist GFX block's status"
	depends on DRM_AMDGPU_DUMP
	default y
	help
	  Selecting this option enables support for persisting
	  AMDGPU's GFX block register status upon GPU hang.

config DRM_AMDGPU_COMPUTE_DUMP
	bool "Persist COMPUTE block's status"
	depends on DRM_AMDGPU_DUMP
	default y
	help
	  Selecting this option enables support for persisting
	  AMDGPU's COMPUTE block register status upon GPU hang.

config DRM_AMDGPU_SDMA_DUMP
	bool "Persist SDMA block's status"
	depends on DRM_AMDGPU_DUMP
	default y
	help
	  Selecting this option enables support for persisting
	  AMDGPU's SDMA block register status upon GPU hang.

config DRM_SGPU_BPMD
	bool "Enable BPMD (Binary PostMortem Dump)"
	default n
	help
	  This option is for SGPU BPMD.

config DRM_SGPU_BPMD_OUTPUT_DEFAULT
	string "Default path to BMPD's output"
	depends on DRM_SGPU_BPMD
	default "/tmp"
	help
	  Serves as a default value for the `bmpdpath` module parameter
```

## drivers/gud/Kconfig
```kconfig
#
# Mobicore Configuration
#
if SOC_EXYNOS2100
source "drivers/gud/gud-exynos2100/Kconfig"
endif
if SOC_S5E9925
source "drivers/gud/gud-s5e9925/Kconfig"
endif
if SOC_S5E8825
source "drivers/gud/gud-s5e8825/Kconfig"
endif
```

## drivers/gud/gud-exynos2100/Kconfig
```kconfig
#
# Trustonic drivers configuration
#
config TRUSTONIC_TEE
    tristate "Trustonic TEE Driver"
    depends on ARM || ARM64
    default m
    help
      Enable Trustonic TEE support

config TRUSTONIC_TEE_DEBUG
    bool "Trustonic TEE driver debug mode"
    depends on TRUSTONIC_TEE
    default n
    help
      Enable the debug mode in the Trustonic TEE Driver.

config TRUSTONIC_TRUSTED_UI
    tristate "Trustonic Trusted UI"
    depends on TRUSTONIC_TEE
    default m
    help
      Enable Trustonic Trusted User Interface

config TRUSTONIC_TRUSTED_UI_FB_BLANK
    bool "Trustonic Trusted UI with fb_blank"
    depends on TRUSTONIC_TRUSTED_UI
    default y
    help
    Blank the framebuffer before starting a TUI session

#
# Secure OS control configuration
#
config SECURE_OS_BOOSTER_API
	bool "Secure OS booster API"
	depends on TRUSTONIC_TEE
	help
	  The secure OS booster API is used for secure OS performance
	  enhancement. It can migrate a core that executes secure OS tasks
	  and lock CPU frequency.

config SECURE_OS_SUPPORT_MCT_DISABLE
	bool "Seucre OS booster API supports MCT disable"
	depends on TRUSTONIC_TEE
	default n
	help
	   When secure OS boosting, MCT is needed to be disabled
	   because of preventing interrupt of MCT.

#
# Secure OS control configuration
#
config SECURE_OS_CONTROL
	bool "Secure OS control"
	depends on TRUSTONIC_TEE
	help
	  Enable Secure OS control sysfs.
	  It can migrate a core that executes secure OS tasks
	  and check a current core on secure OS.

#
# Secure OS Architecture
#
config TRUSTONIC_TEE_64_BIT_ONLY
    bool "64-bit only Trustonic TEE driver"
    depends on TRUSTONIC_TEE
    default n
    help
      Enable 64-bit only Trustonic TEE Driver.
```

## drivers/input/sec_input/stm/Kconfig
```kconfig
# SPDX-License-Identifier: GPL-2.0-only
#
# SLSI TOUCH driver configuration
#

config TOUCHSCREEN_STM
	tristate "STM Touchscreen"
	depends on I2C
    help
      Say Y here if you want support for SEC touchscreen controllers.
      If unsure, say N.

config TOUCHSCREEN_STM_SPI
    tristate "STM SPI Touchscreen"
    depends on SPI
    help
      Say Y here if you want support for STM SPI touchscreen controllers.
      If unsure, say N.
```

## drivers/input/touchscreen/Kconfig.variant1
```kconfig
# SPDX-License-Identifier: GPL-2.0

source "drivers/input/touchscreen/stm/fts5cu56a/Kconfig"

source "drivers/input/touchscreen/sec_input/Kconfig"

source "drivers/input/touchscreen/stm/stm_spi/Kconfig"
```

## drivers/input/touchscreen/focaltech/ft3519/Kconfig
```kconfig
#
# Focaltech Touchscreen driver configuration
#

config TOUCHSCREEN_FTS_FT3519
    tristate "Focaltech Touchscreen"
    default n
    help
      Say Y here if you have Focaltech touch panel.
      If unsure, say N.
```

## drivers/input/touchscreen/novatek/nt36523_spi/Kconfig
```kconfig
#
# Novatek NT36xxx touchscreen driver configuration
#
config TOUCHSCREEN_NOVATEK_NT36523_SPI
	tristate "Novatek NT36xxx SPI driver"
	depends on SPI
	help
	  Say Y here if you have a Novatek NT36xxx no flash touchscreen connected
	  to your system by SPI bus.

	  If unsure, say N.
```

## drivers/input/touchscreen/sec_input/slsi/Kconfig
```kconfig
# SPDX-License-Identifier: GPL-2.0-only
#
# SLSI TOUCH driver configuration
#

config TOUCHSCREEN_SLSI
	tristate "SLSI Touchscreen"
	depends on I2C
    help
      Say Y here if you want support for SEC touchscreen controllers.
      If unsure, say N.
```

## drivers/input/touchscreen/stm/stm_spi/Kconfig
```kconfig
# SPDX-License-Identifier: GPL-2.0-only
#
# STM TOUCH driver configuration
#

config TOUCHSCREEN_STM_SPI
    tristate "STM SPI Touchscreen"
    depends on SPI
    help
      Say Y here if you want support for STM SPI touchscreen controllers.
      If unsure, say N.

config TOUCHSCREEN_STM_SPI_FTS2BA61Y
    bool "STM SPI Touchscreen FTS2BA61Y"
    depends on TOUCHSCREEN_STM_SPI
    help
      Say Y here if you want support for STM SPI FTS2BA61Y touchscreen controllers.
      If unsure, say N.
```

## drivers/knox/ngksm/Kconfig
```kconfig
# @file Kconfig
# @brief Kconfig for Next Generation Knox Security Driver
# Copyright (c) 2019, Samsung Electronics Corporation. All rights reserved.
#
# This program is free software; you can redistribute it and/or modify
# it under the terms of the GNU General Public License version 2 and
# only version 2 as published by the Free Software Foundation.
#
# This program is distributed in the hope that it will be useful,
# but WITHOUT ANY WARRANTY; without even the implied warranty of
# MERCHANTABILITY or FITNESS FOR A PARTICULAR PURPOSE.  See the
# GNU General Public License for more details.

config NGKSM
	bool "Next Generation Knox Security Monitor feature enable"
	default n
	help
	This enables knox securty monitor driver

config NGKPAD
	bool "Next Generation Knox Peripheral Access Detection feature enable"
	depends on NGKSM
	default n
	help
	This enables Next Generation Knox Peripheral Access Detection
```

## drivers/kq/mesh/Kconfig
```kconfig
config SEC_KQ_MESH
	tristate "Samsung KQ MESH support"
	default n
	depends on DRV_SAMSUNG
	help
	  This option enables Samsung KQ MESH features.
	  This module created to enhance system stability.
	  Enable this feature to check MESH system functionality.
	  This module only works with MESH application.
```

## drivers/media/platform/exynos/Kconfig
```kconfig
#
# Exynos multimedia device drivers
#
config VIDEO_EXYNOS
        bool "Exynos Multimedia Devices"
        default y
        help
          This is a representative exynos multimedia device.

if VIDEO_EXYNOS
        source "drivers/media/platform/exynos/mfc/Kconfig"

source "drivers/media/platform/exynos/camera/Kconfig"
source "drivers/media/platform/exynos/camera-pp/Kconfig"
        source "drivers/media/platform/exynos/jsqz/Kconfig"
        source "drivers/media/platform/exynos/mcfrc/Kconfig"
endif
```

## drivers/media/platform/exynos/camera/Kconfig
```kconfig
config VIDEO_EXYNOS_PABLO_ISP
	tristate "Exynos Pablo Camera Driver"
	depends on VIDEO_EXYNOS
	default n
	help
	  This is a v4l2 driver for Exynos Pablo IS.

config DISABLE_CAMERA_MEM_ATTR
	bool "Disable memory attr change"
	depends on VIDEO_EXYNOS_PABLO_ISP
	default n

config DISABLE_CAMERA_SIMD
	bool "Disable simd ops"
	depends on VIDEO_EXYNOS_PABLO_ISP
	default n

config CAMERA_MEM_V2
	bool "Use memory helper V2"
	depends on VIDEO_EXYNOS_PABLO_ISP
	default n
	help
	  Use memory helper version 2.0.

config CAMERA_DVFS_V2
	bool "Use Camera DVFS V2"
	depends on VIDEO_EXYNOS_PABLO_ISP
	default n
	help
	  Enable Camera DVFS v2 feature.

config PABLO_SOCKET_LAYER
	bool "Enable socket layer for Pablo"
	depends on VIDEO_EXYNOS_PABLO_ISP
	default n
	help
	  Enable socket layer for Pablo.

config PABLO_OBTE_SUPPORT
	tristate "Enable obte driver for Pablo"
	depends on VIDEO_EXYNOS_PABLO_ISP
	default n
	help
	  Enable obte driver for Pablo.

config PABLO_KUNIT_TEST
	tristate "KUNIT Test for Pablo"
	depends on VIDEO_EXYNOS_PABLO_ISP && KUNIT
	default n
	help
	  Enable kunit test for Pablo.

# Chain driver
source "drivers/media/platform/exynos/camera/ischain/Kconfig"
source "drivers/media/platform/exynos/camera/hardware/Kconfig"
source "drivers/media/platform/exynos/camera/vendor/Kconfig"

# Sensor driver
source "drivers/media/platform/exynos/camera/sensor/Kconfig"

config EXYNOS_DEVICE_MIPI_CSIS_VER4
	bool "Use Sensor driver (Sensor Group)"
	depends on USE_SENSOR_GROUP
	depends on VIDEO_EXYNOS_PABLO_ISP
	default n
	help
	  Enable Device MIPI-CSIS S/W Version 4(Including WDMA and Sensor Group)

config PABLO_CAMIF_BNS
	bool "Use CAMIF BNS driver"
	depends on VIDEO_EXYNOS_PABLO_ISP
	depends on EXYNOS_DEVICE_MIPI_CSIS_VER4
	default n
	help
	  Enable Pablo CAMIF-BNS driver

source "drivers/media/platform/exynos/camera/csi/Kconfig"
```
