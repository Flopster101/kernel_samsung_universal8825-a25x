## drivers/gpu/arm/Kconfig
```kconfig
# SPDX-License-Identifier: GPL-2.0
#
# (C) COPYRIGHT 2012, 2021 ARM Limited. All rights reserved.
#
# This program is free software and is provided to you under the terms of the
# GNU General Public License version 2 as published by the Free Software
# Foundation, and any use by you of this program is subject to the terms
# of such GNU license.
#
# This program is distributed in the hope that it will be useful,
# but WITHOUT ANY WARRANTY; without even the implied warranty of
# MERCHANTABILITY or FITNESS FOR A PARTICULAR PURPOSE. See the
# GNU General Public License for more details.
#
# You should have received a copy of the GNU General Public License
# along with this program; if not, you can access it online at
# http://www.gnu.org/licenses/gpl-2.0.html.
#
#

menu "ARM GPU Configuration"

choice
	prompt "Mali Version Configuration"
	default MALI_DDK_VALHALL_R32P1 if $(PLATFORM_VERSION_FOR_GPU) = 12
	default MALI_DDK_VALHALL_R32P1 if $(PLATFORM_VERSION_FOR_GPU) >= 13
	help
	  Select Mali GPU driver version.

config MALI_DDK_NONE
	bool "None"

config MALI_DDK_VALHALL_R26P0
	bool "Valhall r26p0 driver"

config MALI_DDK_VALHALL_R32P1
	bool "Valhall r32p1 driver"

config MALI_DDK_VALHALL_R38P1
	bool "Valhall r38p1 driver"

endchoice

if MALI_DDK_VALHALL_R26P0
source "drivers/gpu/arm/bv_r26p0/Kconfig"
endif

if MALI_DDK_VALHALL_R32P1
source "drivers/gpu/arm/bv_r32p1/Kconfig"
endif

if MALI_DDK_VALHALL_R38P1
source "drivers/gpu/arm/bv_r38p1/Kconfig"
endif

endmenu
```

## drivers/gpu/drm/samsung/dpu/Kconfig
```kconfig
config DRM_SAMSUNG_DPU
	tristate "DRM Support for Samsung EXYNOS Series"
	depends on OF && DRM && (SOC_S5E8825 || SOC_S5E9925 || UML)
	select DRM_KMS_HELPER
	select VIDEOMODE_HELPERS
	help
	  Choose this option if you have a Samsung EXYNOS SoC chipset.
	  If M is selected the module will be called exynosdrm. It will
	  control various panel drivers and display hardware on Samsung
	  Exynos SoC chipset.

if DRM_SAMSUNG_DPU

config DRM_SAMSUNG_DPP
	bool "DPP on Exynos"
	default DRM_SAMSUNG_DPU
	depends on DRM_SAMSUNG_DPU
	help
	  This enables support for DPP(Display Pre Processor) device on
	  Samsung Exynos SoC. It will support scaling, rotation, compression
	  and so on.

comment "CRTCs"

config DRM_SAMSUNG_DECON
	bool "DECON on Exynos"
	depends on !FB_S3C && !DRM_EXYNOS
	default DRM_SAMSUNG_DPU
	help
	  Choose this option if you want to use Exynos DECON for DRM. It
	  will control DECON hardware. It can blend all windows connected
	  to DPP.

comment "Encoders and Bridges"

config DRM_SAMSUNG_DSI
	bool "MIPI-DSI host"
	depends on DRM_SAMSUNG_DECON
	select DRM_MIPI_DSI
	select DRM_PANEL
	default DRM_SAMSUNG_DPU
	help
	  This enables support for Exynos MIPI-DSI device. It will encode
	  data as mipi standard and transfer to the mipi panel. It also
	  supports to read and write mipi command to and from the mipi panel.
	  So, this driver can use various panel feature.

config DRM_SAMSUNG_WB
	bool "WB on Exynos"
	depends on DRM_SAMSUNG_DECON
	default DRM_SAMSUNG_DPU
	help
	  This enables support for Exynos Concurrent Writeback device.
	  It can be attached writeback at runtime. It will dump blended
	  output buffer which is displaying on LCD.
	  This means that both writeback and LCD display can be operated
	  simultaneously.

config DRM_SAMSUNG_DP
	bool "DP on Exynos"
	depends on DRM_SAMSUNG_DECON
	default n
	help
	  This enables support for Exynos DisplayPort device. It will encode
	  data as DP standard and transfer to the DP Dongle(USB type C to DP) or monitor.

config DRM_SAMSUNG_HIBERNATION
	bool "Support Display Hibernation"
	depends on DRM_SAMSUNG_DECON
	default DRM_SAMSUNG_DPU
	help
	  This enables support for Exynos Display Hibernation

config DRM_SAMSUNG_HIBERNATION_EARLY_WAKEUP
	bool "Support Hibernation Early Wakeup"
	depends on DRM_SAMSUNG_DECON && DRM_SAMSUNG_HIBERNATION
	default n
	help
	  This enables support for Exynos Hibernation Early Wakeup.
	  Hibernation Early Wakeup will be performed through sysfs.

config EXYNOS_FREQ_HOP
    tristate "Support DPHY PLL Frequency Hopping"
	depends on DRM_SAMSUNG_DECON
	default n

config DRM_SAMSUNG_EWR
    bool "Support early wake up"
	depends on DRM_SAMSUNG_DECON
	default DRM_SAMSUNG_DPU

config EXYNOS_DMA_DSIMFC
    bool "Support DSIM Fast Command"
	depends on DRM_SAMSUNG_DECON
	default n

config DRM_SAMSUNG_DOZE
	bool "Support Doze, Doze_suspend"
	depends on DRM_SAMSUNG_DECON
	default n
	help
	  This enables support for Exynos Display Doze

config EXYNOS_PLL_SLEEP
	bool "Support DPHY PLL Sleep"
	depends on DRM_SAMSUNG_DECON
	default n

config EXYNOS_CMD_SVSYNC
	bool "Support Command Mode Samsung Variable Sync"
	depends on DRM_SAMSUNG_DECON
	default n

config EXYNOS_DRM_BUFFER_SANITY_CHECK
	bool "Support DMA Buffer Sanity Check for Debugging"
        depends on DRM_SAMSUNG_DECON
        default n

config SEC_DISPLAYPORT
	bool "Enable featuring of CONFIG_SEC_DISPLAYPORT"
	default n
	help
	  Enable SEC DISPLAYPORT config to check if DP support.

config USE_DISPLAYPORT_PDIC_EVENT_QUEUE
	bool "use queue for PDIC notifications"
	depends on DRM_SAMSUNG_DP
	default n
	help
	  Enable PDIC event queue

config SEC_DISPLAYPORT_DBG
	bool "SEC_DISPLAYPORT_DBG feature"
	depends on SEC_DISPLAYPORT
	help
	  Samsung specific debug code for displayport

config DRM_DPU_EVENT_LOG_FOR_USER
	bool "Support DRM DPU Event log for user"
	depends on DRM_SAMSUNG_DECON
	default DRM_SAMSUNG_DPU
	help
	  This enables support for DRM DPU Event log for user

source "drivers/gpu/drm/samsung/dpu/panel/Kconfig"
source "drivers/gpu/drm/samsung/dpu/dp_ext_func/Kconfig"
source "drivers/gpu/drm/samsung/dpu/mcd_cal/Kconfig"

endif
```

## drivers/gpu/drm/samsung/dpu/mcd_cal/Kconfig
```kconfig
config DRM_MCD_COMMON
	bool "Support Samsung MCD DPU Driver base on DRM"
	depends on DRM_SAMSUNG_DPU

config DRM_MCD_HDR
	bool "Support MCD HDR Driver base on DRM"
	depends on DRM_MCD_COMMON
	default n
	help
	   This enables support for wcg/hdr using hardware ip designed by mcd.
```

## drivers/gpu/drm/samsung/dpu/panel/Kconfig
```kconfig
config DRM_PANEL_SAMSUNG_COMMON
	tristate "Samsung Common panel"
	depends on OF
	depends on DRM_MIPI_DSI
	select VIDEOMODE_HELPERS

config DRM_PANEL_SAMSUNG_EMUL
	tristate "Samsung EMUL DSI command mode panel"
	depends on DRM_PANEL_SAMSUNG_COMMON
	help
	  This driver supports virtual panel on samsung emulator. It just
	  supports to turn on and off the virtual panel. Also if proper
	  panel driver couldn't be found, it can be chosen.

config DRM_PANEL_SAMSUNG_S6E3FAB
	tristate "Samsung S6E3FAB DSI command mode panel"
	depends on DRM_PANEL_SAMSUNG_COMMON
	help
	  This driver supports S6E3FAB panel on samsung SoC. It supports
	  to turn on and off the S6E3FAB panel and it can also supports
	  panel specific features.

config DRM_PANEL_SAMSUNG_S6E3FAC
	tristate "Samsung S6E3FAC DSI command mode panel"
	depends on DRM_PANEL_SAMSUNG_COMMON
	help
	  This driver supports S6E3FAC panel on samsung SoC. It supports
	  to turn on and off the S6E3FAC panel and it can also supports
	  panel specific features.

config DRM_PANEL_SAMSUNG_S6E3HAB
	tristate "Samsung S6E3HAB DSI command mode panel"
	depends on DRM_PANEL_SAMSUNG_COMMON
	help
	  This driver supports S6E3HAB panel on samsung SoC. It supports
	  to turn on and off the S6E3HAB panel and it can also supports
	  panel specific features.

config DRM_PANEL_SAMSUNG_S6E3FC3
	tristate "Samsung S6E3FC3 DSI command mode panel"
	depends on DRM_PANEL_SAMSUNG_COMMON
	help
	  This driver supports S6E3FC3 panel on samsung SoC. It supports
	  to turn on and off the S6E3FC3 panel and it can also supports
	  panel specific features.

config DRM_PANEL_SAMSUNG_S6E8FC1
	tristate "Samsung S6E8FC1 DSI video mode panel"
	depends on DRM_PANEL_SAMSUNG_COMMON
	help
	  This driver supports S6E8FC1 panel on samsung SoC. It supports
	  to turn on and off the S6E8FC1 panel and it can also supports
	  panel specific features.

config DRM_PANEL_MCD_COMMON
	tristate "Samsung MCD Common panel"
	depends on OF
	depends on DRM_MIPI_DSI
	select VIDEOMODE_HELPERS
```

## drivers/gpu/drm/samsung/panel/Kconfig
```kconfig
config USDM_PANEL
	tristate "Samsung MX Panel Driver"
	select BACKLIGHT_CLASS_DEVICE
	default n
	help
		Enable USDM Panel Driver.

config USDM_MDNIE
	bool "Support MDNIE LITE"
	depends on USDM_PANEL
	default n

config USDM_MDNIE_AFC
	bool "Support AFC"
	depends on USDM_PANEL && USDM_MDNIE
	default n

config USDM_PANEL_SYSFS
	bool "Support LCD SYSFS"
	depends on USDM_PANEL
	default y

config USDM_COPR_SPI
	bool "Support LCD SPI"
	depends on USDM_PANEL
	default n

config USDM_PANEL_COPR
	bool "Support COPR"
	depends on USDM_PANEL
	default n

config USDM_MDNIE_TUNING
	bool "Support LCD TUNING"
	depends on USDM_PANEL
	default n

config USDM_PANEL_DIMMING
	bool "Support AID Dimming"
	depends on USDM_PANEL
	default y

config USDM_PANEL_MULTI_RESOLUTION
	bool "Support DSU(Multi Resolution)"
	depends on USDM_PANEL
	default n

config USDM_PANEL_HMD
	bool "Support HMD(Head Mount Display - VR)"
	depends on USDM_PANEL
	default n

config USDM_PANEL_LPM
	bool "Support LPM(Low Power Mode) Driver"
	depends on USDM_PANEL
	default n

config USDM_PANEL_SELF_DISPLAY
	bool "Support Extend Live Clock Functions(For Always On Display)"
	depends on USDM_PANEL
	default n

config USDM_PANEL_AOD_BL
	bool "Support AOD(Always On Display) BL(BackLight) Driver"
	depends on USDM_PANEL && USDM_PANEL_LPM
	default n

config USDM_PANEL_DDI_FLASH
	bool "Support display ddi flash"
	depends on USDM_PANEL
	default n

config USDM_PANEL_POC_FLASH
	bool "Support display poc flash"
	depends on USDM_PANEL
	default n

config USDM_PANEL_MAFPC
	bool "SUPPORT MAFPC function"
	depends on USDM_PANEL
	default n

config USDM_PANEL_MAFPC_CRC
	bool "SUPPORT MAFPC CRC function"
	depends on USDM_PANEL
	default n

config USDM_PANEL_DIM_FLASH
	bool "Support display dimming flash"
	depends on USDM_PANEL && USDM_PANEL_DDI_FLASH
	default n

config USDM_FACTORY_GCT_TEST
	bool "Support GRAM Checksum"
	depends on USDM_PANEL
	default n

config USDM_FACTORY_CCD_TEST
	bool "Support CCD TEST"
	depends on USDM_PANEL
	default n

config USDM_FACTORY_SSR_TEST
	bool "Support SSR TEST"
	depends on USDM_PANEL
	default n

config USDM_FACTORY_ECC_TEST
	bool "Support ECC TEST"
	depends on USDM_PANEL
	default n

config USDM_PANEL_BACKLIGHT_PAC_3_0
	bool "Support baclight PAC 3.0"
	depends on USDM_PANEL
	default n

config USDM_PANEL_DPUI
	bool "Support display use info logging"
	depends on USDM_PANEL
	default n

config USDM_POC_SPI
	bool "Support poc SPI connection"
	depends on USDM_PANEL
	default n

config USDM_PANEL_GM2_FLASH
	bool "Support to get Gamma-mode2 panel info from flash"
	depends on USDM_PANEL
	default n

config USDM_PANEL_FREQ_HOP
	bool "Support Panel Frequency Hopping"
	depends on USDM_PANEL
	default n

config USDM_PANEL_DISPLAY_MODE
	bool "Support panel display mode"
	depends on USDM_PANEL
	default n

config USDM_FACTORY
	bool "mcd-panel for factory binary"
	depends on USDM_PANEL
	default SEC_FACTORY

config USDM_FACTORY_FAST_DISCHARGE
	bool "Support fast discharge function"
	depends on USDM_PANEL && USDM_FACTORY
	default n

config USDM_PANEL_DEBUG
	bool "Support panel debug"
	depends on USDM_PANEL
	default y

config USDM_PANEL_MASK_LAYER
	bool "Support FP mask layer function"
	depends on USDM_PANEL
	default n

config USDM_PANEL_ERRFG_RECOVERY
	bool "Support ERRFG recovery"
	depends on USDM_PANEL
	default n

config USDM_FACTORY_MST_TEST
	bool "Support MST Test"
	depends on USDM_PANEL
	default n

config USDM_FACTORY_BRIGHTDOT_TEST
	bool "Support Brightdot Test"
	depends on USDM_PANEL
	default n

config USDM_FACTORY_VGLHIGHDOT_TEST
	bool "Support VGL Highdot Test"
	depends on USDM_PANEL
	default n

config USDM_FACTORY_DSC_CRC_TEST
	bool "Support panel decoder test"
	depends on USDM_PANEL
	default n

config USDM_PANEL_EVASION_DISP_DET
    bool "Support avoid disp_det interrupt"
    depends on USDM_PANEL
    default n

config USDM_DDI_CMDLOG
	bool "Support DDI Command Log"
	depends on USDM_PANEL
	default n

config USDM_BLIC_I2C
	bool "Support mcd panel i2c"
	depends on USDM_PANEL
	default n

config USDM_PANEL_BLIC
	bool "Support mcd panel blic"
	depends on USDM_PANEL
	default n

config USDM_PANEL_BIG_LOCK
	bool "Support mcd panel big lock"
	depends on USDM_PANEL
	default n

config USDM_PANEL_RCD
	bool "Support mcd panel rcd"
	depends on USDM_PANEL && !USDM_FACTORY
	default n

config USDM_PANEL_ID_READ_REG_04
	bool "Using ID READ Register 04h"
	depends on USDM_PANEL
	default n

config USDM_PANEL_ID_READ_REG_DADBDC
	bool "Using ID READ Register DA/DB/DCh"
	depends on USDM_PANEL
	default n

config USDM_PANEL_ID_READ_REG_ADAEAF
	bool "Using ID READ Register AD/AE/AFh"
	depends on USDM_PANEL
	default n

config USDM_PANEL_ID_READ_BY_LPDT
	bool "Using ID READ by LPDT"
	depends on USDM_PANEL
	default n

config USDM_PANEL_ID_READ_BY_HSDT
	bool "Using ID READ by HSDT"
	depends on USDM_PANEL
	default n

config USDM_PANEL_TESTMODE
	bool "SUPPORT PANEL TEST MODE"
	depends on USDM_PANEL && !SAMSUNG_PRODUCT_SHIP
	default n

config USDM_PANEL_JSON
	bool "Support mcd panel json parser/writer"
	depends on USDM_PANEL
	default n

config USDM_PANEL_VCOM_TRIM_TEST
	bool "Support VCOM TRIM test"
	depends on USDM_PANEL
	default n

config USDM_LPD_AUTO_BR
	bool "Support lpd auto brightness"
	depends on USDM_PANEL
	default n

config USDM_ADAPTIVE_MIPI
	bool "Support Adaptive MIPI"
	depends on USDM_PANEL
	default n

config USDM_SDP_ADAPTIVE_MIPI
	bool "Support SDP Adaptive MIPI"
	depends on USDM_PANEL
	depends on SDP
	default n

config USDM_USE_CUSTOM_SOFTDEP
	bool "Support Custom softdep"
	depends on USDM_PANEL
	default n

config USDM_PANEL_UEVENT_RECOVERY
	bool "Support uevent recovery"
	depends on USDM_PANEL
	default n

config USDM_PANEL_LATE_PROBE
	bool "Support Late Probe"
	depends on USDM_PANEL
	default n
```

## drivers/gpu/drm/samsung/panel/oled_common/Kconfig
```kconfig
menuconfig USDM_PANEL_OLED_COMMON
	tristate "OLED_COMMON DDI Panel Driver"
	depends on USDM_PANEL
	default y
	help
		This enables OLED_COMMON DDI dependent panel drivers of
		common panel driver. say Y, if you have a panel based on
		the OLED_COMMON DDI.
```

## drivers/gpu/drm/samsung/panel/s6e3fc3/Kconfig
```kconfig
menuconfig USDM_PANEL_S6E3FC3
	tristate "S6E3FC3 DDI Panel Driver"
	depends on USDM_PANEL
	depends on USDM_PANEL_OLED_COMMON
	default n
	help
		This enables S6E3FC3 DDI dependent panel drivers of
		common panel driver. say Y, if you have a panel based on
		the S6E3FC3 DDI.
```

## drivers/gpu/drm/samsung/panel/tft_common/Kconfig
```kconfig
menuconfig USDM_PANEL_TFT_COMMON
	tristate "TFT_COMMON DDI Panel Driver"
	depends on USDM_PANEL
	default n
	help
		This enables TFT_COMMON DDI dependent panel drivers of
		common panel driver. say Y, if you have a panel based on
		the TFT_COMMON DDI.


menuconfig USDM_PANEL_HX83102E_GTA4XLS_00
	tristate "USDM_PANEL_HX83102E_GTA4XLS_00 DDI Panel Driver"
	depends on USDM_PANEL_TFT_COMMON
	default n
	help
		This enables HX83102E_GTA4XLS_00 DDI dependent panel drivers of
		common panel driver. say Y, if you have a panel based on
		the NT36672C_XCOVER7_00 DDI.
```

## drivers/gpu/drm/samsung/panel_decon/s6e3fc3/Kconfig
```kconfig
menuconfig EXYNOS_DECON_LCD_S6E3FC3
	tristate "S6E3FC3 DDI Panel Driver"
	depends on MCD_PANEL
	default n
	help
		This enables S6E3FC3 DDI dependent panel drivers of
		common panel driver. say Y, if you have a panel based on
		the S6E3FC3 DDI.

menuconfig EXYNOS_DECON_LCD_S6E3FC3_M34X
	tristate "S6E3FC3 DDI Panel Driver"
	depends on MCD_PANEL
	default n
	help
		This enables S6E3FC3 M34X DDI dependent panel drivers of
		common panel driver. say Y, if you have a panel based on
		the S6E3FC3 DDI.
```
