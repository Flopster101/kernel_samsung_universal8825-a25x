## drivers/media/platform/exynos/camera/csi/Kconfig
```kconfig
config CSIS_V1_2
	bool "Use CSI H/W v1.2"
	depends on PABLO_V8_20_0
	help
	  csi version 1.2

config CSIS_V5_3
	bool "Use CSI H/W v5.3"
	depends on PABLO_V8_1_0 || PABLO_V8_10_0
	help
	  csi version 5.3

config CSIS_V5_4
	bool "Use CSI H/W v5.4"
	depends on PABLO_V9_1_0 || PABLO_V9_10_0 || PABLO_V10_20_0
	help
	  csi version 5.4

config CSIS_V8_0
	bool "Use CSI H/W v8.0"
	depends on PABLO_V10_0_0 || PABLO_V10_1_0
	help
	  csi version 8.0
```

## drivers/media/platform/exynos/camera/hardware/api/Kconfig
```kconfig
config MC_SCALER_V8_1
	bool "Use MC-SCALER H/W v8.1"
	depends on PABLO_V8_1_0
	default n
	help
	  use mc-scaler v8.1

config MC_SCALER_V8_10
	bool "Use MC-SCALER H/W v8.10"
	depends on PABLO_V8_10_0
	default n
	help
	  use mc-scaler v8.10

config MC_SCALER_V8_20
	bool "Use MC-SCALER H/W v8.20"
	depends on PABLO_V8_20_0
	default n
	help
	  use mc-scaler v8.20

config MC_SCALER_V9_1
	bool "Use MC-SCALER H/W v9.1"
	depends on PABLO_V9_1_0
	default n
	help
	  use mc-scaler v9.1

config MC_SCALER_V9_10
	bool "Use MC-SCALER H/W v9.10"
	depends on PABLO_V9_10_0
	default n
	help
	  use mc-scaler v9.10

config MC_SCALER_V10_0
	bool "Use MC-SCALER H/W v10.0"
	depends on PABLO_V10_0_0
	default n
	help
	  use mc-scaler v10.0

config MC_SCALER_V10_1
	bool "Use MC-SCALER H/W v10.1"
	depends on PABLO_V10_1_0
	default n
	help
	  use mc-scaler v10.1

config MC_SCALER_V10_20
	bool "Use MC-SCALER H/W v10.20"
	depends on PABLO_V10_20_0
	default n
	help
	  use mc-scaler v10.20

config VRA_V2_0
	bool "Use VRA H/W v2.0"
	depends on PABLO_V8_20_0
	default n
	help
	  use vra v2.0

config PDP_V1_0_0
        bool "Use PDP H/W v1.0.0"
	depends on  PABLO_V8_1_0 || PABLO_V8_10_0
        default n
        help
          use PDP v1.0.0

config PDP_V3_1
        bool "Use PDP H/W v3.1"
	depends on PABLO_V9_1_0 || PABLO_V9_10_0 || PABLO_V10_20_0
        default n
        help
          use PDP v3.1

config PDP_V4_0
	bool "Use PDP H/W v4.0"
	depends on PABLO_V10_0_0
	default n
	help
	  use PDP v4.0

config PDP_V4_1
	bool "Use PDP H/W v4.1"
	depends on PABLO_V10_1_0
	default n
	help
	  use PDP v4.1

config CSTAT_V1_0
	bool "Use CSTAT H/W v1.0"
	depends on PABLO_V10_0_0
	default n
	help
	 use CSTAT v1.0

config CSTAT_V1_1
	bool "Use CSTAT H/W v1.1"
	depends on PABLO_V10_1_0
	default n
	help
	 use CSTAT v1.1

config YUVPP_V2_1
        bool "Use YUVPP H/W v2.1"
	depends on PABLO_V9_1_0 || PABLO_V9_10_0 || PABLO_V10_20_0
        default n
	help
	  use YUVPP v2.1

config BYRP_V1_0
        bool "Use BYRP H/W v1.0"
	depends on PABLO_V10_0_0
        default n
        help
          use BYRP v1.0

config BYRP_V1_1
        bool "Use BYRP H/W v1.1"
	depends on PABLO_V10_1_0
        default n
        help
          use BYRP v1.1

config RGBP_V1_0
        bool "Use RGBP H/W v1.0"
	depends on PABLO_V10_0_0
        default n
        help
          use RGBP v1.0

config RGBP_V1_1
        bool "Use RGBP H/W v1.1"
	depends on PABLO_V10_1_0
        default n
        help
          use RGBP v1.1

config LME_V1_1
	bool "Use LME H/W v1.1"
	depends on PABLO_V9_1_0 || PABLO_V9_10_0
	default n
	help
	  use LME v1.1

config LME_V2_0
	bool "Use LME H/W v2.0"
	depends on PABLO_V10_0_0
	default n
	help
	  use LME v2.0

config LME_V2_1
	bool "Use LME H/W v2.1"
	depends on PABLO_V10_1_0
	default n
	help
	  use LME v2.1

config MCFP_V10_0
        bool "Use MCFP H/W v10.0"
	depends on PABLO_V10_0_0
        default n
        help
          use MCFP v10.0

config MCFP_V10_1
        bool "Use MCFP H/W v10.1"
	depends on PABLO_V10_1_0
        default n
        help
          use MCFP v10.1

config YUVP_V1_0
        bool "Use YUVP H/W v1.0"
	depends on PABLO_V10_0_0
        default n
        help
          use YUVP v1.0

config YUVP_V1_1
        bool "Use YUVP H/W v1.1"
	depends on PABLO_V10_1_0
        default n
        help
          use YUVP v1.1

config DRCP_V1_0
        bool "Use DRCP H/W v1.0"
	depends on PABLO_V10_0_0
        default n
        help
          use DRCP v1.0

config TAA_V9_20
        bool "Use TAA H/W v9.20"
	depends on PABLO_V10_20_0
        default n
        help
          use 3AA v9.20

config ORBMCH_V2_1
	bool "Use ORBMCH H/W v2.1"
	depends on PABLO_V10_20_0
	default n
	help
	  use ORBMCH v2.1

config DNS_V1_20
        bool "Use DNS H/W v1.20"
	depends on PABLO_V10_20_0
        default n
        help
          use DNS v1.20

config ITP_V1_20
        bool "Use ITP H/W v1.20"
	depends on PABLO_V10_20_0
        default n
        help
          use ITP v1.0

config MCFP_V10_20
	bool "Use MCFP H/W v10.20"
	depends on PABLO_V10_20_0
	default n
	help
	  use MCFP v10.20
```

## drivers/media/platform/exynos/camera/ischain/Kconfig
```kconfig
config PABLO_V8_1_0
	bool "Use PABLO v8.1.0"
	depends on SOC_EXYNOS9830
	default y
	select EXYNOS_DEVICE_MIPI_CSIS_VER4
	select CSIS_V5_3
	select CAMERA_CIS_SELECT
	select CAMERA_ACT_SELECT
	select CAMERA_FLASH_SELECT
	select CAMERA_PDP
	select MC_SCALER_V8_1
	select PDP_V1_0_0
	help
	  PABLO ISP version 8.1.0

config PABLO_V8_10_0
	bool "Use PABLO v8.10.0"
	depends on SOC_EXYNOS9630
	default y
	select EXYNOS_DEVICE_MIPI_CSIS_VER4
	select CSIS_V5_3
	select CAMERA_CIS_SELECT
	select CAMERA_ACT_SELECT
	select CAMERA_FLASH_SELECT
	select CAMERA_PDP
	select MC_SCALER_V8_10
	select PDP_V1_0_0
	help
	  PABLO ISP version 8.0.0

config PABLO_V8_20_0
	bool "Use PABLO v8.20.0"
	depends on SOC_EXYNOS3830
	default y
	select EXYNOS_DEVICE_MIPI_CSIS_VER4
	select CSIS_V1_2
	select CAMERA_CIS_SELECT
	select CAMERA_ACT_SELECT
	select CAMERA_FLASH_SELECT
	select MC_SCALER_V8_20
	help
	  PABLO ISP version 8.20.0

config PABLO_V9_1_0
	bool "Use PABLO v9.1.0"
	depends on SOC_EXYNOS2100
	default y
	select EXYNOS_DEVICE_MIPI_CSIS_VER4
	select CSIS_V5_4
	select CAMERA_CIS_SELECT
	select CAMERA_ACT_SELECT
	select CAMERA_FLASH_SELECT
	select CAMERA_PDP
	select CAMERA_DVFS_V2
	select CAMERA_MEM_V2
	select MC_SCALER_V9_1
	select PDP_V3_1
	select YUVPP_V2_1
	select LME_V1_1
	help
	  PABLO ISP version 9.1.0

config PABLO_V9_10_0
	bool "Use PABLO v9.10.0"
	depends on SOC_S5E9815
	default y
	select EXYNOS_DEVICE_MIPI_CSIS_VER4
	select CSIS_V5_4
	select CAMERA_CIS_SELECT
	select CAMERA_ACT_SELECT
	select CAMERA_FLASH_SELECT
	select CAMERA_PDP
	select CAMERA_DVFS_V2
	select CAMERA_MEM_V2
	select MC_SCALER_V9_10
	select PDP_V3_1
	select YUVPP_V2_1
	select LME_V1_1
	help
	  PABLO ISP version 9.10.0

config PABLO_V10_0_0
	bool "Use PABLO v10.0.0"
	depends on SOC_S5E9925_EVT0
	default y
	select EXYNOS_DEVICE_MIPI_CSIS_VER4
	select CSIS_V8_0
	select CAMERA_CIS_SELECT
	select CAMERA_ACT_SELECT
	select CAMERA_FLASH_SELECT
	select CAMERA_PDP
	select CAMERA_DVFS_V2
	select CAMERA_MEM_V2
	select MC_SCALER_V10_0
	select PDP_V4_0
	select CSTAT_V1_0
	select BYRP_V1_0
	select RGBP_V1_0
	select MCFP_V10_0
	select YUVP_V1_0
	select DRCP_V1_0
	select LME_V2_0
	help
	  PABLO ISP version 10.0.0

config PABLO_V10_1_0
	bool "Use PABLO v10.1.0"
	depends on SOC_S5E9925
	depends on !SOC_S5E9925_EVT0
	default y
	select EXYNOS_DEVICE_MIPI_CSIS_VER4
	select CSIS_V8_0
	select PABLO_CAMIF_BNS
	select CAMERA_CIS_SELECT
	select CAMERA_ACT_SELECT
	select CAMERA_FLASH_SELECT
	select CAMERA_PDP
	select CAMERA_DVFS_V2
	select CAMERA_MEM_V2
	select MC_SCALER_V10_1
	select PDP_V4_1
	select CSTAT_V1_1
	select BYRP_V1_1
	select RGBP_V1_1
	select MCFP_V10_1
	select YUVP_V1_1
	select LME_V2_1
	help
	  PABLO ISP version 10.1.0

config PABLO_V10_20_0
	bool "Use PABLO v10.20.0"
	depends on SOC_S5E8825
	default y
	select EXYNOS_DEVICE_MIPI_CSIS_VER4
	select CSIS_V5_4
	select CAMERA_CIS_SELECT
	select CAMERA_ACT_SELECT
	select CAMERA_FLASH_SELECT
	select CAMERA_PDP
	select CAMERA_DVFS_V2
	select CAMERA_MEM_V2
	select PDP_V3_1
	select TAA_V9_20
	select ORBMCH_V2_1
	select MCFP_V10_20
	select DNS_V1_20
	select ITP_V1_20
	select MC_SCALER_V10_20
	help
	  PABLO ISP version 10.20.0
```

## drivers/media/platform/exynos/camera/sensor/Kconfig
```kconfig
config EXYNOS_DEVICE_CAMERA_MODULE
	bool "Use Camera modules"
	depends on VIDEO_EXYNOS_PABLO_ISP
	default y
	help
	  Select camera module.

source "drivers/media/platform/exynos/camera/sensor/module_framework/Kconfig"
```

## drivers/media/platform/exynos/camera/sensor/module_framework/i2c_dummy/Kconfig
```kconfig
menuconfig CAMERA_I2C_DUMMY
	bool "I2C DUMMY"
	depends on EXYNOS_DEVICE_CAMERA_MODULE
	help
		Say Y here to enable support for platform-specific V4L drivers.
```

## drivers/media/platform/exynos/camera/sensor/module_framework/laser_af/Kconfig
```kconfig
menuconfig CAMERA_LASER_AF_SELECT
	bool "Laser af select"
	depends on EXYNOS_DEVICE_CAMERA_MODULE
	help
		Say Y here to enable support for platform-specific V4L drivers.

config CAMERA_LASER_AF_TOF8801_OBJ
	bool "Use TOF8801"
	depends on CAMERA_LASER_AF_SELECT
	default n
	help
		Use to build TOF8801 driver.

config CAMERA_LASER_AF_VL53L5_OBJ
	tristate "Use VL53L5"
	depends on EXYNOS_DEVICE_CAMERA_MODULE
	depends on SENSORS_VL53L5
	default n
	help
		Use to build VL53L5 driver.
```

## drivers/media/platform/exynos/camera/vendor/Kconfig
```kconfig
#menu depth2
menu "Vendor Feature Setting"
	depends on VIDEO_EXYNOS_PABLO_ISP

choice VENDER_FEATURES
	prompt "Use vender features"
	depends on VIDEO_EXYNOS_PABLO_ISP
	default CAMERA_VENDER_DEFAULT
	help
	  Use the vender specific features.

config CAMERA_VENDER_DEFAULT
        bool "Default"
config CAMERA_VENDER_MCD
        bool "MCD"
config CAMERA_VENDER_MCD_V2
        bool "MCD_V2"
endchoice

source "drivers/media/platform/exynos/camera/vendor/default/Kconfig"
source "drivers/media/platform/exynos/camera/vendor/mcd/Kconfig"
source "drivers/media/platform/exynos/camera/vendor/mcd_v2/Kconfig"
endmenu
```

## drivers/media/platform/exynos/camera/vendor/mcd_v2/Kconfig
```kconfig
config CAMERA_EEPROM_SUPPORT_REAR
        tristate "Enable eeprom for rear cam"
        depends on CAMERA_VENDER_MCD_V2
        default m
        help
          Enable eeprom for rear cam.
config CAMERA_OTPROM_SUPPORT_REAR
        tristate "Enable otprom for rear cam"
        depends on CAMERA_VENDER_MCD_V2
        default n
        help
          Enable otprom for rear cam.
config SENSOR_RETENTION_USE
	bool "Use sensor retention"
	depends on CAMERA_VENDER_MCD_V2
	default n
	help
	  Use sensor retention.
config OIS_USE
        bool "Use ois"
        depends on CAMERA_VENDER_MCD_V2
        default n
        help
          Use ois.
config OIS_FW_UPDATE_THREAD_USE
        bool "Enable ois fw update thread"
        depends on OIS_USE
        default n
        help
          Enable ois fw update thread.
config AF_HOST_CONTROL
        bool "Enable host af control"
        depends on CAMERA_VENDER_MCD_V2
        default n
        help
          Enable host af control.
config IS_DDK_DATA_LOAD
        bool "Enable signed binary processing."
        depends on CAMERA_VENDER_MCD_V2
        default n
        help
          Enable signed binary processing.
config TORCH_CURRENT_CHANGE_SUPPORT
        bool "Change torch current in recording mode"
        depends on CAMERA_VENDER_MCD_V2
        default n
        help
          Change torch current in recording mode.
config CAMERA_USE_INTERNAL_MCU
        bool "Use internal MCU for OIS"
        depends on CAMERA_VENDER_MCD_V2
        default n
        help
          Use internal MCU for OIS
config CAMERA_USE_MCU
        bool "Use Camera mcu"
        depends on CAMERA_VENDER_MCD_V2
        default n
        help
          Use Camera mcu
config CAMERA_USE_AOIS
        bool "Use Camera AOIS"
        depends on CAMERA_VENDER_MCD_V2
        default n
        help
          Use Camera AOIS
config CAMERA_AAW_A25X
        bool "This camera is aaw_a25x"
        depends on CAMERA_VENDER_MCD_V2
        default n
        help
          This camera is aaw_a25x
config CAMERA_AAV_A53X
        bool "This camera is aav_a53x"
        depends on CAMERA_VENDER_MCD_V2
        default n
        help
          This camera is aav_a53x
config CAMERA_AAV_A33X
        bool "This camera is aav_a33x"
        depends on CAMERA_VENDER_MCD_V2
        default n
        help
          This camera is aav_a33x
config CAMERA_MMV_M33X
        bool "This camera is mmv_m33x"
        depends on CAMERA_VENDER_MCD_V2
        default n
        help
          This camera is mmv_m33x
config CAMERA_MMW_M34X
        bool "This camera is mmw_m34x"
        depends on CAMERA_VENDER_MCD_V2
        default n
        help
          This camera is mmw_m34x
config CAMERA_STX_V04
        bool "This camera is stx_v04"
        depends on CAMERA_VENDER_MCD_V2
        default n
        help
          This camera is stx_v04
```

## drivers/media/platform/exynos/jsqz/Kconfig
```kconfig
#
# Exynos multimedia device drivers
#
config VIDEO_EXYNOS_JPEG_SQZ
        tristate "Exynos Jpeg Squeeze driver"
        depends on VIDEO_EXYNOS
        default n
        help
          This is a representative exynos Jpeg squeezer device
```

## drivers/media/platform/exynos/mcfrc/Kconfig
```kconfig
#
# Exynos multimedia device drivers
#
config VIDEO_EXYNOS_MC_FRC
        tristate "Exynos MC FRC driver"
        depends on VIDEO_EXYNOS
        help
          This is a representative exynos MC FRC device
```

## drivers/media/platform/exynos/mfc/Kconfig
```kconfig
config VIDEO_EXYNOS_MFC
	tristate "Exynos MFC Driver"
	default n
	depends on VIDEO_EXYNOS
	select VIDEOBUF2_CORE
	select VIDEOBUF2_DMA_SG
	help
	  MFC driver for V4L2.

config MFC_USES_LLC
	bool "MFC LLC support"
	default y
	depends on VIDEO_EXYNOS_MFC
	help
	  Uses the LLC of MFC.

config MFC_USE_DMABUF_CONTAINER
	bool "MFC dma-buf container support"
	default n
	depends on VIDEO_EXYNOS_MFC
	help
	  Use dma-buf container for MFC.

config MFC_USE_DMA_SKIP_LAZY_UNMAP
	bool "MFC support for DMA_ATTR_SKIP_LAZY_UNMAP"
	default y
	depends on VIDEO_EXYNOS_MFC
	help
	  Use dma-buf attribute for skip lazy unmap.

config MFC_USE_COREDUMP
	bool "MFC COREDUMP support"
	default n
	depends on VIDEO_EXYNOS_MFC
	help
	When MFC occurs an error, this supports COREDUMP for debugging.
```

## drivers/media/radio/s610/Kconfig
```kconfig
#
# SAMSUNG's S620 FM driver based on SPEEDY driver.
#
menu "Samsung S620 FM driver (SPEEDY based)"
config RADIO_S620
	tristate "Samsung S620 FM Radio"
	depends on VIDEO_V4L2 && RADIO_S5E8825
	help
	Choose Y here if you have this FM radio chip.

endmenu
```

## drivers/mfd/Kconfig.variant1
```kconfig
# SPDX-License-Identifier: GPL-2.0-only

source "drivers/mfd/max77705/Kconfig"
source "drivers/mfd/sm5714/Kconfig"
```

## drivers/mfd/slsi/s2mf301/Kconfig
```kconfig
config MFD_S2MF301
tristate "Samsung Electronics S2MF301 IF PMIC Series Support"
	depends on I2C=y
	select MFD_CORE
	help
	  Support for the Samsung Electronics MFD series.
	  This driver provides common support for accessing the device,
	  additional drivers must be enabled in order to use the functionality
	  of the device
```

## drivers/mfd/slsi/s2mu106/Kconfig
```kconfig
config MFD_S2MU106
	tristate "Samsung Electronics S2MU106 IF PMIC Series Support"
	depends on I2C=y
	select MFD_CORE
	help
	  Support for the Samsung Electronics MFD series.
	  This driver provides common support for accessing the device,
	  additional drivers must be enabled in order to use the functionality
	  of the device
```

## drivers/mfd/sm/sm5714/Kconfig
```kconfig
config MFD_SM5714
        tristate "Siliconmitus SM5714 IFPM Support"
        depends on I2C=y
        select MFD_CORE
        help
          Say yes here to support for Siliconmitus SM5714.
          This is a Power Management IC with Single Flash, Charger, Type-C, MUIC, FG
          controls on chip.
          This driver provides common support for accessing the device;
          additional drivers
```
