## drivers/misc/tui/Kconfig
```kconfig
config SAMSUNG_TUI
	tristate "Samsung Trustzone Teegris UI"
	bool "TUI HW Handler"
	default n
	help
		Provide methods for TUI such as acquisition of buffer
		to be used as secure frame buffer in Secure World and
		synchronization of display and touch device between
		Normal World and Secure World.

config SAMSUNG_TUI_LOWLEVEL
	bool "TUI HW Low Level mode"
	default n
	depends on SAMSUNG_TUI
	help
		Enables tui low level API.

config SAMSUNG_TUI_TEST
	bool "Testing module for TUI HW handler"
	default n
	depends on SAMSUNG_TUI
	help
		support TUI Driver Test
```

## drivers/muic/common/Kconfig
```kconfig
#
# MUIC devices
#

comment "MUIC configs"

config USE_MUIC
	bool "Using MUIC device driver"
	depends on I2C
	default n
	help
	  If you say yes here you will get support for
	  the MUIC device driver.

config MUIC_NOTIFIER
	tristate "MUIC notifier support"
	depends on USE_MUIC
	default n
	help
	  If you say yes here you will get support for
	  the MUIC attached device status change notification.

config MUIC_MANAGER
	tristate "MUIC Manager supports PDIC chip interface"
	depends on USE_MUIC
	default n
	help
	  If you say yes here you will get support manager for the PDIC chip.

config MUIC_CORE
	bool "Supports MUIC Core"
	depends on USE_MUIC
	default n
	help
	  If you say yes here you will get support for the MUIC Core functionalities

config MUIC_HV
	bool "MUIC_HV"
	depends on USE_MUIC || MUIC_UNIVERSAL
	default n
	help
	  If you say yes here you will get support for the AFC.

config MUIC_SUPPORT_PDIC
	bool "MUIC supports PDIC chip interface"
	depends on USE_MUIC
	default n
	help
	  If you say yes here you will get support for the PDIC chip.

config MUIC_SUPPORT_POWERMETER
	bool "MUIC supports PM chip interface"
	depends on USE_MUIC
	default n
	help
	  If you say yes here you will get support for the Power Meter.

config MUIC_COMMON_SYSFS
	bool "Using muic sysfs Features"
	depends on MUIC_NOTIFIER
	default n
	help
	  If you say yes here you will get support for the muic sysfs.
	  some ic drivers may have sysfs in own driver.
	  But we recommend driver to use this common sysfs.
	  new ic driver must use this feature.

config MUIC_USE_MODULE_PARAM
	bool "Using module param"
	depends on MUIC_NOTIFIER
	default n
	help
	  If this feature is enabled, muic_core will use module_param directly.
	  Should not use extern variable and __setup for param.
	  need to add cmdline in bootloader.
	  (ex: common_muic.xxx)

config HICCUP_CC_DISABLE
	bool "Using HICCUP CC disable"
	depends on USE_MUIC
	default n
	help
	  If you say yes here you will get support for
	  for the hiccup cc disable feature.

config HV_MUIC_VOLTAGE_CTRL
	bool "Using AFC Voltage control functionality"
	depends on MUIC_HV_S2MU004_AFC || MUIC_HV
	default n
	help
	  If you say yes here you will get support for
	  the AFC voltage control functionality.

config HICCUP_CHARGER
	bool "Using HICCUP charger"
	depends on USE_MUIC
	default n
	help
		If you say yes here you will get support for
		for the hiccup charger feature.

config MUIC_SUPPORT_PRSWAP
	bool "MUIC supports power role swap"
	depends on USE_MUIC
	default n
	help
	  If you say yes here you will get support for the power role swap.

config SIDO_OVP
	bool "Using SIDO(Single Input Dual Output) dual ovp structure"
	depends on USE_MUIC
	default n
	help
	  If you say yes here, you will get support for SIDO structure.
	  we use this feature to be distinguish MUIC operation
	  for SISO/SIDO OVP circuit design.
```

## drivers/muic/slsi/platform/Kconfig
```kconfig
#
# MUIC platform
#

comment "MUIC platform configs"

config MUIC_PLATFORM
	tristate "MUIC platform support"
	depends on MUIC_NOTIFIER
	default n
	help
	  A wrapper layer dedicated to lsi for using muic common layer.
	  Used to fill the callback function of muic_pdata.
	  It is used from s2mm006.

config MUIC_SUPPORT_POWERMETER
	bool "MUIC supports PM chip interface"
	depends on USE_MUIC
	default n
	help
	  If you say yes here you will get support for the Power Meter.

config HV_MUIC_VOLTAGE_CTRL
	bool "Using AFC Voltage control functionality"
	default n
	help
	  If you say yes here you will get support for
	  the AFC voltage control functionality.

config MUIC_SUPPORT_PRSWAP
	bool "MUIC supports power role swap"
	depends on USE_MUIC
	default n
	help
	  If you say yes here you will get support for the power role swap.

config SIDO_OVP
	bool "Using SIDO(Single Input Dual Output) dual ovp structure"
	depends on USE_MUIC
	default n
	help
	  If you say yes here, you will get support for SIDO structure.
	  we use this feature to be distinguish MUIC operation
	  for SISO/SIDO OVP circuit design.
```

## drivers/muic/slsi/s2mf301/Kconfig
```kconfig
config MUIC_S2MF301
	tristate "Using S2MF301 MUIC"
	depends on USE_MUIC && MFD_S2MF301
	default n
	help
	  If you say yes here you will get support for the S2MF301 MUIC chip.

config TOP_S2MF301
	bool "Using S2MF301 MUIC"
	depends on USE_MUIC && MFD_S2MF301
	default n
	help
	  If you say yes here you will get support
	  for the S2MF301 Top driver
	  for RID detection, Full-auto DC
	  ''

config TOP_S2MF301_SUPPORT_S2MC501
    bool "Using S2MF301 TOP support auto pps"
    default n
    help
      If you say yes here you will get support
      for the S2MF301 Top driver
      for auto pps function with S2MC501
      ''

config HV_MUIC_S2MF301_AFC
	tristate "Using S2MF301 MUIC AFC"
	depends on MUIC_HV && MUIC_S2MF301
	default n
	help
	  If you say yes here you will get support for the AFC.

config HV_MUIC_AFC_DISABLE_ENFORCE
	bool "Using S2MF301 MUIC AFC DISABLE ENFORCE"
	depends on HV_MUIC_S2MF301_AFC
	default n
	help
	  If you say yes here you will disable AFC charging.

config MUIC_S2MF301_RID
	bool "Using S2MF301 MUIC RID"
	depends on MUIC_S2MF301
	default n
	help
	  If you say yes here you will get support for the S2MF301 MUIC RID functions.

config MUIC_NOT_SUPPORT_QC
	bool "Not using S2MF301 MUIC QC AFC"
	depends on MUIC_HV && MUIC_S2MF301
	default n
	help
	  If you say yes here you will get support for the NOT QC AFC.

config MUIC_HV_SUPPORT_POGO_DOCK
	bool "MUIC_HV_SUPPORT_POGO_DOCK"
	depends on USE_MUIC
	default n
	help
	  If you say yes here you will get support for the AFC pogo dock.
```

## drivers/muic/slsi/s2mu106/Kconfig
```kconfig
config MUIC_S2MU106
	tristate "Using S2MU106 MUIC"
	depends on USE_MUIC && MFD_S2MU106
	default n
	help
	  If you say yes here you will get support for the S2MU106 MUIC chip.

config HV_MUIC_S2MU106_AFC
	tristate "Using S2MU106 MUIC AFC"
	depends on MUIC_HV && MUIC_S2MU106
	default n
	help
	  If you say yes here you will get support for the AFC.

config HV_MUIC_AFC_DISABLE_ENFORCE
	bool "Using S2MU106 MUIC AFC DISABLE ENFORCE"
	depends on HV_MUIC_S2MU106_AFC
	default n
	help
	  If you say yes here you will disable AFC charging.

config MUIC_S2MU106_RID
	bool "Using S2MU106 MUIC RID"
	depends on MUIC_S2MU106
	default n
	help
	  If you say yes here you will get support for the S2MU106 MUIC RID functions.

config S2MU106_TYPEC_WATER
	bool "Using S2MU106 Type-C Water Detection"
	depends on MUIC_S2MU106_RID
	default n
	help
	  If you say yes here you will get support for
	  the S2MU106 Type-C Water functions.

config MUIC_NOT_SUPPORT_QC
	bool "Not using S2MU106 MUIC QC AFC"
	depends on MUIC_HV && MUIC_S2MU106
	default n
	help
	  If you say yes here you will get support for the NOT QC AFC.

config MUIC_HV_SUPPORT_POGO_DOCK
	bool "MUIC_HV_SUPPORT_POGO_DOCK"
	depends on USE_MUIC
	default n
	help
	  If you say yes here you will get support for the AFC pogo dock.
```

## drivers/muic/sm/sm5714/Kconfig
```kconfig
config MUIC_SM5714
	tristate "SM5714 MUIC"
	depends on USE_MUIC
	default n
	help
	  If you say yes here you will get support for the SM5714 MUIC chip.

config MUIC_BCD_RESCAN
	bool "SM5714 MUIC supports BC 1.2 retry"
	depends on MUIC_SM5714
	default n
	help
	  If you say yes here you will get support for the BC 1.2 retry in SM5714 MUIC chip.

config MUIC_QC_DISABLE
	bool "SM5714 MUIC doesn't support QC charging"
	depends on MUIC_SM5714
	default n
	help
	  If you say yes here you will not get support for the QC charging in SM5714 MUIC chip.
```

## drivers/muic_old/common/Kconfig
```kconfig
#
# MUIC devices
#

comment "MUIC configs"

config LEGACY_USE_MUIC
    bool "Using MUIC device driver (legacy)"
    depends on I2C
    depends on USE_MUIC
    default n
    help
      If you say yes here you will get support for
      the MUIC device driver.

config LEGACY_MUIC_NOTIFIER
    tristate "MUIC notifier support (legacy)"
    depends on LEGACY_USE_MUIC
    default n
    help
      If you say yes here you will get support for
      the MUIC attached device status change notification.

config LEGACY_MUIC_MANAGER
    tristate "MUIC Manager supports PDIC chip interface (legacy)"
    depends on LEGACY_USE_MUIC
    default n
    help
      If you say yes here you will get support manager for the PDIC chip.

config LEGACY_MUIC_CORE
    bool "Supports MUIC Core (legacy)"
    depends on LEGACY_USE_MUIC
    default n
    help
      If you say yes here you will get support for the MUIC Core functionalities

config LEGACY_MUIC_HV
    bool "MUIC_HV (legacy)"
    depends on LEGACY_USE_MUIC || LEGACY_MUIC_UNIVERSAL
    default n
    help
      If you say yes here you will get support for the AFC.

config LEGACY_MUIC_SUPPORT_PDIC
    bool "MUIC supports PDIC chip interface (legacy)"
    depends on LEGACY_USE_MUIC
    default n
    help
      If you say yes here you will get support for the PDIC chip.

config LEGACY_MUIC_SUPPORT_POWERMETER
    bool "MUIC supports PM chip interface (legacy)"
    depends on LEGACY_USE_MUIC
    default n
    help
      If you say yes here you will get support for the Power Meter.

config LEGACY_MUIC_SYSFS
    bool "Using muic sysfs Features (legacy)"
    depends on LEGACY_USE_MUIC
    default n
    help
      If you say yes here you will get support for the muic sysfs.

config LEGACY_MUIC_USE_MODULE_PARAM
    bool "Using module param (legacy)"
    depends on LEGACY_MUIC_NOTIFIER
    default n
    help
      If this feature is enabled, muic_core will use module_param directly.
      Should not use extern variable and __setup for param.
      need to add cmdline in bootloader.
      (ex: common_muic.xxx)

config LEGACY_HV_MUIC_VOLTAGE_CTRL
    bool "Using AFC Voltage control functionality (legacy)"
    depends on LEGACY_MUIC_HV_S2MU004_AFC || LEGACY_MUIC_HV
    default n
    help
      If you say yes here you will get support for
      the AFC voltage control functionality.

config LEGACY_HICCUP_CHARGER
    bool "Using HICCUP charger (legacy)"
    depends on LEGACY_USE_MUIC
    default n
    help
        If you say yes here you will get support for
        for the hiccup charger feature.

config LEGACY_MUIC_SUPPORT_PRSWAP
    bool "MUIC supports power role swap (legacy)"
    depends on LEGACY_USE_MUIC
    default n
    help
      If you say yes here you will get support for the power role swap.

config LEGACY_SIDO_OVP
    bool "Using SIDO(Single Input Dual Output) dual ovp structure (legacy)"
    depends on LEGACY_USE_MUIC
    default n
    help
      If you say yes here, you will get support for SIDO structure.
      we use this feature to be distinguish MUIC operation
      for SISO/SIDO OVP circuit design.
```

## drivers/nfc/Kconfig
```kconfig
#
# near field communication configuration
#
config SAMSUNG_NFC
	tristate "Samsung NFC driver"
	default n
	help
	  Say Y here if you want to build support for NFC (Near field
	  communication) devices.
	  To compile this support as a module, choose M here: the module will
	  be called nfc.

config SEC_NFC
	bool "Samsung NFC driver"
	default n
	help
	  SAMSUNG NFC Driver.
	  This driver provides support for SAMSUNG NFC products.
	  You should select your NFC product and interface.
	  Say Y here to compile support for SAMSUNG NFC driver into the
	  kernel.
config NFC_PVDD_LATE_ENABLE
        bool "PVDD late enable"
        default n
        help
          If lpcharge value is not usable,
          then PVDD is enabled lately by init.nfc.samsung.rc on late-init.
          And this should be enabled from S os projects.
config ESE_P3_LSI
	bool "eSE driver"
	depends on SPI
	default n
	help
	  Oberthur Driver.
	  This driver provides support for LSI NXP combined ESE products.
	  You should select your NFC product and interface.
	  Say Y here to compile support for eSE driver into the kernel.
config ESE_COLDRESET
	bool "eSE support coldreset"
	depends on ESE_P3_LSI
	default n
	help
	  Cold reset function supported.
	  This function supports for LSI ESE products.
	  You should select your NFC product and interface.
	  Say Y here to compile support for eSE driver into the kernel.
config ESE_USE_REGULATOR
	bool "eSE use regulator"
	depends on ESE_P3_LSI
	default n
	help
	  ESE is on and off by regulator.
	  This function supports for LSI ESE products.
	  You should select your NFC product and interface.
	  Say Y here to compile support for eSE driver into the kernel.
config MAKE_NODE_USING_PLATFORM_DEVICE
        bool "eSE platform driver"
        default n
        help
          Using eSE platform driver.
          Sometimes eSE node is created after permission setting
          cause of SPI driver dependency.
          So, use platform driver to make node first.
config ESE_FACTORY_ONLY
	bool "eSE driver factory"
	depends on SPI
	default n
	help
	  Oberthur Driver.
	  This driver provides support for LSI NXP combined ESE products.
	  You should select your NFC product and interface.
config ESE_SECURE
	bool "ESE Secure Controller Driver"
	depends on !SEC_FACTORY
	default n
	help
	  Common eSE Secure controller support.
	  This option enables device driver support for the eSE with NFC.
	  It is used by many services. eSE is fully controlled using SPI
	  to communication

config NFC_ST21NFC
	bool "STM's ST21NFC Feature"
	default n
	help
	  STM's ST21NFC Near Field Communication controller support
	  This option enables device driver support for the NFC.
	  It is used by many services. NFC is fully controlled using I2C
	  to communicate the AP chip.

config NFC_ST54SPI_ESE_SUPPORT
	tristate "STM's Secure Element protocol driver (SPI) devices"
	depends on SPI
	help
	  This enables the Secure Element driver for ST21NFC based devices.
	  If unsure, say N.
	  This selects Secure Element support.
	  If you want NFC support, you should say Y here and
	  also to your specific host controller driver.

config ESE_USE_TZ_API
        bool "use tz api"
        depends on NFC_ST54SPI_ESE_SUPPORT
        default n
        help
          Enable when using TZ API.
	  You should select this feature if your NFC product
          uses S.LSI AP and TZ API.
	  Say Y here to compile support for TZ API.

config SEC_NFC_LOGGER
        bool "NFC logger"
        default n
        help
          Enable NFC log.
          NFC log will be recorded at proc folder.
          but will not included at dumpstate log.
          so need to copy this file to log folder.

config SEC_NFC_LOGGER_ADD_ACPM_LOG
        bool "NFC logger: add acpm log"
        default n
        depends on SEC_NFC_LOGGER
        help
          add acpm log.
          this feature is for particualr AP.
          rtc reg addr is needed to compare time
config SEC_NFC_LOGGER_RTC_REG_ADDR
        hex "NFC logger: add acpm log"
        default 0x0
        depends on SEC_NFC_LOGGER_ADD_ACPM_LOG
        help
          RTC time is to compare between acpm and kernel.
          address value is hex.

config NFC_QTI_I2C
        tristate "QTI NCI based NFC I2C Driver for ST21NFC"
        depends on I2C
        help
          This enables the NFC driver for ST21NFC based devices.
          This is for I2C connected version. NCI protocol logic
          resides in the usermode and it has no other NFC dependencies.

          If unsure, say N.

config SEC_NFC_COMPAT_IOCTL
        bool "NFC compat ioctl"
        default n
        help
          Enable NFC compat ioctl.
```
