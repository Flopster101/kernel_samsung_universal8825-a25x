## drivers/soc/samsung/debug/Kconfig
```kconfig
menuconfig EXYNOS_DEBUG
        bool "Exynos Debug Features"
        depends on ARCH_EXYNOS
        default n

if EXYNOS_DEBUG
menuconfig DEBUG_SNAPSHOT
	tristate "Debug SnapShot Support"
	depends on EXYNOS_DEBUG
	default n
	help
	  Debug snapshot supports SoC debugging easily. This feature supports
	  to trace kernel events and other module events such frequceny change
	  and IPC. This supports to save GPR and PC when panic or exception and
	  to enter ramdump mode when panic is occurred and other exception.
	  This supports to reserve memory for h/w debug feature such as
	  scan2dram, arraydump.

config DEBUG_SNAPSHOT_API
	bool "Support Debug Snapshot API"
	depends on DEBUG_SNAPSHOT
	default n
	help
	  Debug Snapshot API supports access of dss log and dss log item.
	  If you use this API, you can get last or first index, paddr of item.

config DEBUG_SNAPSHOT_FREQ_DOMAIN_NUM
	int "Number of freq logging domain type"
	range 4 32
	default 32
	help
	  This option decides number of frequency logging domain type.

config DEBUG_SNAPSHOT_LOG_ITEM_SIZE
	int "Number of logging item base size"
	range 256 1024
	default 1024
	help
	  This option decides size of logging item.

config DEBUG_SNAPSHOT_SFRDUMP
	tristate "Debug Snapshot SFRDUMP"
	depends on DEBUG_SNAPSHOT
	default n
	help
	  This supports sfrdump to string format into the DRAM
	  if kernel panic happened. If you want to get dump,
	  you should write list of sfr registers in device tree.
	  If you want to dump sfr register, you say Y here.

config DEBUG_SNAPSHOT_QUICKDUMP
	tristate "Debug Snapshot quickdump"
	depends on DEBUG_SNAPSHOT
	default n
	help
	  This is for weight ligntening of ramdump. If DRAM size is too big,
	  Ramdump is also big. Then it takes a long time to get ramdump.
	  So we get important data such as dss logging and H/W raw data.
	  If you access text symbol and stack data, you could get them.

config DEBUG_SNAPSHOT_DEBUG_KINFO
	tristate "Debug Kernel Information Support"
	depends on DEBUG_SNAPSHOT
        default n
	help
	  This prepares memory for the debug-kinfo driver

config EXYNOS_DEBUG_TEST
        tristate "Exynos debug feature test"
        depends on DEBUG_SNAPSHOT
        default n
	help
	  This can be tested for various errors. If you say y you can confirm
	  that the debug feature works properly for the error.

config EXYNOS_ITMON
        tristate "Exynos IPs Traffic Monitor"
        depends on EXYNOS_DEBUG
        default n

config EXYNOS_CORESIGHT
        tristate "Enable Coresight of exynos"
	depends on DEBUG_SNAPSHOT
        default n
	help
	  This is support to show PC values of each cpus when kernel panic
	  caused by hard lockup.

config EXYNOS_ECC_HANDLER
	tristate "Exynos support ECC handler"
	depends on DEBUG_SNAPSHOT
	default n
	help
	  If ECC happened in cache of CPU, interrupt occurs to cpu.

config EXYNOS_HARDLOCKUP_WATCHDOG
	tristate "Exynos Hardlockup Watchdog"
	depends on DEBUG_SNAPSHOT
	default n

config EXYNOS_ADV_TRACER
        tristate "Exynos Advanced Tracer"
        depends on ARM || ARM64
        default n
	help
	  This driver communicates with debugcore via mailbox. This supports
	  ipc API with debugcore. If you make a driver to communicates with
	  debugcore, you should use this API.

config EXYNOS_ADV_TRACER_S2D
        tristate "Exynos Advanced Tracer: Plug-in - S2D"
        depends on EXYNOS_ADV_TRACER
        default n
	help
	  This driver communicates with scan2dram plugin in debugcore.

config EXYNOS_EHLD
        tristate "Exynos support Early Hardlockup Detector"
        depends on EXYNOS_DEBUG
        default n

config EXYNOS_SSLD
        tristate "Exynos support S2R Scenario Lockup Detector"
        depends on EXYNOS_DEBUG
        default n

endif
```

## drivers/soc/samsung/gnssif/Kconfig
```kconfig
config EXYNOS_GNSS_IF
	tristate "Exynos GNSS interface driver"
	default n
	help
	  Exynos GNSS interface driver
```

## drivers/spu_verify/Kconfig
```kconfig
config SPU_VERIFY
	tristate "SPU Sign Verify Driver"
	default n
        select ASYMMETRIC_KEY_TYPE
        select ASYMMETRIC_PUBLIC_KEY_SUBTYPE
        select CRYPTO_RSA
	help
	  This option enables SPU sign verify driver.
	  When SPU fireware update, image signature verify.
	  Each firmware is checked by calling a function before updating.
	  If disable config, maybe Signature checking cause problems.
```

## drivers/staging/android/Kconfig.variant1
```kconfig
# SPDX-License-Identifier: GPL-2.0

source "drivers/staging/android/switch/Kconfig"
```

## drivers/staging/binder_prio/Kconfig
```kconfig
config BINDER_PRIO
	tristate "Xiaomi binder prio"
	depends on ANDROID_BINDER_IPC
	default y
```

## drivers/staging/nanohub/Kconfig
```kconfig
config NANOHUB
	tristate "Nanohub"
	default N
	select IIO
	help
	  Enable support for the nanohub sensorhub driver.

	  This driver supports the android nanohub sensorhub.

	  If in doubt, say N here.

if NANOHUB

config NANOHUB_MAILBOX
	bool "Nanohub Mailbox"
	default Y
	help
	  Enable nanohub Mailbox support.

	  Either this or NANOHUB_MAILBOX should be selected.

	  If in doubt, say N here.

config SENSOR_DRV
	bool "Sensor driver to support exynos sensor Hal"
	default N
	help
	  Enable sensorhub hal support.

config CONTEXTHUB_DEBUG
	bool "Nanohub debug"
	default N
	help
	  Enable nanohub device debug message

config CONTEXTHUB_SENSOR_DEBUG
	bool "Nanohub sensor debug"
	default N
	help
	  Enable nanohub seneor alive check

config LOGBUF_NUM
	int "Nanohub logbuf number"
	depends on NANOHUB
	default 230 if SOC_S5E5515 || SOC_S5E9925 || SOC_S5E8825
	help
	  A number of logbuf lines, depends on soc

endif # NANOHUB
```

## drivers/usb/typec/Kconfig.variant1
```kconfig
# SPDX-License-Identifier: GPL-2.0

source "drivers/usb/typec/manager/Kconfig"
source "drivers/usb/typec/common/Kconfig"
source "drivers/usb/typec/maxim/Kconfig"
source "drivers/usb/typec/sm5714/Kconfig"
```

## drivers/usb/typec/slsi/common/Kconfig
```kconfig
#
# PDIC devices
#

comment "PDIC configs"

config PDIC_SLSI_NON_MCU
	tristate "Using USBPD device driver"
	depends on I2C
	default n
	help
	  If you say yes here you will get support for
	  the S.LSI Non MCU USB PD(Power Delivery) device driver.

config PDIC_PD30
	bool "support PD30"
	depends on PDIC_SLSI_NON_MCU
	default n
	help
	  If you say yes here you will get support for PD30

config S2MU106_TYPEC_WATER
	bool "Using S2MU Type-C Water Detection"
	depends on I2C && (MFD_S2MU106 || PM_S2MU106)
	default n
	help
	  If you say yes here you will get support for
	  the S2MU Type-C Water functions.

config S2MU106_TYPEC_WATER_SBU
	bool "Using Type-C Water through SBU1/2"
	depends on I2C && (MFD_S2MU106 || PM_S2MU106 || S2MU106_TYPEC_WATER)
	default n
	help
	  If you say yes here you will get support for
	  the S2MU Type-C Water with SBU1/2 functions.

config SUPPORT_USB_TYPEC_OPS
	bool "Using TYPEC OPS since kernel 5.4 version"
	default n
	help
	  If you say yes here you will get support for
	  the Type-C OPS.

config S2M_SUPPORT_DELAYED_REQUEST_MESSAGE_UFP
	bool "Using delayed request message in UFP"
	default n
	help
	  If you say yes here you will get support for
	  the delayed request message in ufp.
```

## drivers/usb/typec/slsi/s2mf301/Kconfig
```kconfig
#
# PDIC devices
#

comment "PDIC configs"

config PDIC_S2MF301
  tristate "Using S2MF301 USB PD"
  depends on PDIC_SLSI_NON_MCU
  default n
  help
    If you say yes here you will get support for
    for the S2MF301 USBPD chip.

config S2MF301_PDIC_TRY_SNK
  bool "Using Type-C try.SNK"
  depends on I2C && (MFD_S2MF301 || PM_S2MF301)
  default n
  help
    If you say yes here you will get support for
    the S2MF301 Type-C try.SNK.
    The device prefer to work with snk.
    This feature is in typec specificaion.
```

## drivers/usb/typec/slsi/s2mu106/Kconfig
```kconfig
#
# PDIC devices
#

comment "PDIC configs"

config PDIC_S2MU106
  tristate "Using S2MU106 USB PD"
  depends on PDIC_SLSI_NON_MCU
  default n
  help
    If you say yes here you will get support for
    for the S2MU106 USBPD chip.

config S2MU106_PDIC_TRY_SNK
  bool "Using Type-C try.SNK"
  depends on I2C && (MFD_S2MU106 || PM_S2MU106)
  default n
  help
    If you say yes here you will get support for
    the S2MU106 Type-C try.SNK.
    The device prefer to work with snk.
    This feature is in typec specificaion.
```

## drivers/usb/typec/sm/sm5714/Kconfig
```kconfig
#
# sm5714 driver
#

comment "SM5714 configs"

config PDIC_SM5714
	tristate "Using SM5714 USB PD"
	default n
	help
	  If you say yes here you will get support for
	  the SM5714 USBPD chip.

config SM5714_FACTORY_MODE
	bool "Using SM5714 USB PD"
	depends on PDIC_SM5714
	default n
	help
	  If you say yes here you will get support for
	  the SM5714 FACTORY MODE.

config PDIC_PD30
	bool "support PD3.0"
	depends on PDIC_SM5714
	default n
	help
	  If you say yes here you will get support for PD3.0

config SM5714_WATER_DETECTION_ENABLE
	bool "Using sm5714 Type-C Water Detection"
	depends on I2C
	default n
	help
	  If you say yes here you will get support for
	  the sm5714 Type-C Water functions.

config SM5714_SUPPORT_SBU
	bool "Using sm5714 Type-C support sbu"
	depends on I2C
	default n
	help
	  If you say yes here you will get support for
	  the sm5714 Type-C support sbu.

config SUPPORT_USB_TYPEC_OPS
	bool "Using TYPEC OPS since kernel 5.4 version"
	depends on PDIC_SM5714
	default n
	help
	  If you say yes here you will get support for
	  the sm5714 Type-C OPS.

config SM5714_DISABLE_PD
	bool "Disable Power Delevery Operation"
	depends on PDIC_SM5714
	default n
	help
	  If you say yes here you will get support for
	  the Disable sm5714 PD OPS.
```

## drivers/usb/typec/sm5714/Kconfig
```kconfig
#
# sm5714 driver
#

comment "SM5714 configs"

config PDIC_SM5714
	tristate "Using SM5714 USB PD"
	default n
	help
	  If you say yes here you will get support for
	  the SM5714 USBPD chip.

config SM5714_FACTORY_MODE
	bool "Using SM5714 USB PD"
	depends on PDIC_SM5714
	default n
	help
	  If you say yes here you will get support for
	  the SM5714 FACTORY MODE.

config PDIC_PD30
	bool "support PD3.0"
	depends on PDIC_SM5714
	default n
	help
	  If you say yes here you will get support for PD3.0

config SM5714_WATER_DETECTION_ENABLE
	bool "Using sm5714 Type-C Water Detection"
	depends on I2C
	default n
	help
	  If you say yes here you will get support for
	  the sm5714 Type-C Water functions.

config SM5714_SUPPORT_SBU
	bool "Using sm5714 Type-C support sbu"
	depends on I2C
	default n
	help
	  If you say yes here you will get support for
	  the sm5714 Type-C support sbu.
```

## drivers/vibrator/dc/Kconfig
```kconfig
config DC_VIBRATOR
	tristate "SEC DC Vibrator"
	default n
	help
	  If you say yes here you will get support for the
	  SEC DC Vibrator.

config DC_VIBRATOR_TEST
	bool "KUnit test for dc_vibrator_test"
	depends on SEC_KUNIT
	help
	  This driver is for dc vibrator test driver
	  dc vibrator kunit test
	  If you want to add some functions,
	  Please make the test case.
```
