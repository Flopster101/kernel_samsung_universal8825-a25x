## drivers/samsung/pm/Kconfig
```kconfig
# drivers/samsung/pm/Kconfig
#
# Copyright (c) 2010-2021 Samsung Electronics Co., Ltd.
#		http://www.samsung.com/
#
# Licensed under GPLv2
#
comment "Samsung Mobile Power Management Options"
menuconfig SEC_PM
	bool "Samsung Mobile Power Management"
	default n
	help
	  This option enables support for various drivers and features for
	  Samsung Mobile Power Management.

config SEC_PM_DEBUG
	tristate "Enable Samsung Mobile Power management debug support"
	default n
	depends on SEC_PM
	help
	  This option enables Samsung Mobile Power management debug support.
	  Intended for test and debug only.

config SEC_PM_THERMISTOR
    tristate "SEC Thermistor support"
    depends on SEC_PM && IIO
    default n
    help
      This driver supports SEC Thermistor sensor reading and its
      interpretation. This driver uses the industrial I/O subsystem
      and needs adc-temperature mapping table for conversion.

config SEC_PM_CPUFREQ
	tristate "Enable Samsung Mobile CPU Frequency control support"
	default n
	depends on SEC_PM && SEC_FACTORY
	help
	  This option enables Samsung Mobile CPU Frequency control support.
	  Adjust the minimum and maximum frequency for each CPU clusters.

config SEC_WAKEUP_CPU_ALLOCATOR
    tristate "SEC Wakeup cpu support"
    depends on SEC_PM
    default n
    help
      This driver supports SEC Wakeup cpu support

config RTC_AUTO_PWRON
	tristate "RTC Auto Power on PMICs"
	depends on SEC_PM
	default n
	help
	  Support for the auto power on alarm on the PMIC.
```

## drivers/sensorhub/Kconfig
```kconfig
config SHUB
	tristate "shub"
	default y
	help
	  shub driver for sensor hub.
	  If you say yes here you get shub support for sensor hub.
	  To compile this driver as a module, choose M here: the module will be called shub.

config SHUB_PM_WAKEUP_LINUX_VER_5_4
	tristate "pm wakeup linux version 5.4"
	default y
	help
	  ssp driver for sensor hub.
	  If you say yes here, the code of pm_wakeup is applied over linux version 5.4.
	  To compile this driver as a module, choose M here: the
	  module will be called ssp.

config SHUB_AOIS
	tristate "SHUB_AOIS"
	default n
	help
	  This is AOIS driver for camera
	  Set as y if the driver is used in this project
	  use CONFIG_SHUB_AOIS

config SHUB_PANEL_NOTIFY
	tristate "SHUB_PANEL_NOTI"
	default n
	help
	  This is panel notify for chub
	  Set as y if the driver is used in this project

config SHUB_KUNIT
	tristate "Kunit test for SHUB"
	depends on KUNIT
	default n
	help
	  Kunit test for SHUB.

config SHUB_TEST_FOR_ON_DEVICE
	tristate "KUnit test for shub_test"
	depends on KUNIT
	depends on SHUB
	help
	  TODO: Describe config fully.
	  If you run this test driver on device, SHOULD set this config as 'm' to build test driver modulraly.

config SHUB_TEST_FOR_ONLY_UML
	tristate "KUnit test for shub_test"
	depends on KUNIT
	depends on UML
	depends on SHUB
	help
	  TODO: Describe config fully.
	  This CONFIG is recommended to set to y.

config SHUB_ACCELEROMETER_TEST
	tristate "KUnit test for shub_accelerometer"
	depends on KUNIT
	depends on UML
	depends on SHUB
	help
	  TODO: Describe config fully.
	  This CONFIG is recommended to set to y.

config SHUB_GYROSCOPE_TEST
	tristate "KUnit test for shub_gyroscope"
	depends on KUNIT
	depends on UML
	depends on SHUB
	help
	  TODO: Describe config fully.
	  This CONFIG is recommended to set to y.

config SHUB_PROXIMITY_TEST
	tristate "KUnit test for shub_proximity"
	depends on KUNIT
	depends on UML
	depends on SHUB
	help
    TODO: Describe config fully.
    This CONFIG is recommended to set to y

config SHUB_LIGHT_TEST
	tristate "KUnit test for shub_light"
	depends on KUNIT
	depends on UML
	depends on SHUB
	help
	  TODO: Describe config fully.
	  This CONFIG is recommended to set to y.

config SHUB_PRESSURE_TEST
	tristate "KUnit test for shub_pressure"
	depends on KUNIT
	depends on UML
	depends on SHUB
	help
	  TODO: Describe config fully.
	  This CONFIG is recommended to set to y.

config SHUB_MAGNETOMETER_TEST
	tristate "KUnit test for shub_magnetometer"
	depends on KUNIT
	depends on UML
	depends on SHUB
	help
	  TODO: Describe config fully.
	  This CONFIG is recommended to set to y.

config SHUB_SCONTEXT_TEST
	tristate "KUnit test for shub_scontext"
	depends on KUNIT
	depends on UML
	depends on SHUB
	help
	  TODO: Describe config fully.
	  This CONFIG is recommended to set to y.
```

## drivers/sensorhub/debug/Kconfig
```kconfig
config SHUB_DEBUG
	tristate "sensor hub debug mode"
	default n
	help
	  If you want to use debug mode for sensor hub, it should be set.
```

## drivers/sensorhub/sensor/Kconfig
```kconfig
config SENSORS_SSP_LIGHT_JPNCONCEPT
	tristate "Light sensor JPN concept"
	default n
	help
	  light sensor JPN concept. send region to Sensor Hub.
```

## drivers/sensorhub/sensorhub/Kconfig
```kconfig
config SHUB_MODULE
	tristate "shub module"
	default n

config SHUB_FIRMWARE_DOWNLOAD
	tristate "Sensor hub firmware download"
	default n

config SHUB_AP_STATUS_CMD
	tristate "sensor hub at status command"
	default n
	help
		if you say yes, send command to sensorhub when ap suspend or resume

config SHUB_SPU
	tristate "Sensor hub spu firmware download"
	default n
```

## drivers/sensorhub/vendor/Kconfig
```kconfig
config SHUB_MTK
	tristate "Mediatek project"
	default n

config SHUB_LSI
	tristate "lsi sensorhub"
	default y
```

## drivers/sensors_lego/Kconfig
```kconfig
#
# grip sensors configuration
#
config SENSORS_A96T396
	depends on I2C
	tristate "A96T396 driver for grip"
	default n
	help
	  If you say yes here if you use A96T396 for grip.
	  This option enables grip sensors using
	  Above A96T396 device driver for grip.

config SENSORS_A96T396_SUB
	depends on I2C
	tristate "A96T396_SUB driver for grip"
	default n
	help
	  Say Y here if you use A96T396_SUB for grip.
	  This option enables grip sensors using
	  Above A96T396_SUB device driver for grip.

config SENSORS_A96T396_SUB2
	depends on I2C
	tristate "A96T396_SUB2 driver for grip"
	default n
	help
	  Say Y here if you use A96T396_SUB2 for grip.
	  This option enables grip sensors using
	  Above A96T396_SUB2 device driver for grip.

config SENSORS_A96T396_WIFI
	depends on I2C
	tristate "A96T396_WIFI driver for grip"
	default n
	help
	  Say Y here if you use A96T396_WIFI for grip.
	  This option enables grip sensors using
	  Above A96T396_WIFI device driver for grip.

config SENSORS_A96T396_LDO_SHARE
	depends on I2C
	tristate "SENSOR_A96T396_LDO_SHARE driver for grip"
	default n
	help
	  Say Y here if you use SENSOR_A96T396_LDO_SHARE for grip.
	  This option enables grip sensors using
	  Above SENSOR_A96T396_LDO_SHARE device driver for grip.

config SENSORS_A96T396_CRC_CHECK
	bool "check crc check instead of checksum compare"
	default n
	help
	  Say Y here if you use crc check instead of checksum compare

config SENSORS_A96T396_A13X
	depends on I2C
	tristate "SENSORS_A96T396_A13X driver for grip firmware"
	default n
	help
	  Say Y here if you use A13X model grip firmware.

config SENSORS_A96T396_A13X_EUR
	depends on I2C
	tristate "SENSORS_A96T396_A13X_EUR driver for grip firmware"
	default n
	help
	  Say Y here if you use A13X_EUR model grip firmware.

config SENSORS_A96T396_A13X_KOR
	depends on I2C
	tristate "SENSORS_A96T396_A13X_KOR driver for grip firmware"
	default n
	help
	  Say Y here if you use A13X_KOR model grip firmware.

config SENSORS_A96T396_BENZ2
	depends on I2C
	tristate "benz2 driver for grip firmware and 'sensor_core'"
	default n
	help
	Say Y here if you use Benz2 grip firmware.

config SENSORS_A96T396_A13
	depends on I2C
	tristate "for grip sensor firmware of A13_LTE"
	default n
	help
	Say Y here if you use A13_LTE grip firmware.

config SENSORS_A96T396_A13_KOR
	depends on I2C
	tristate "for grip sensor firmware of A13_LTE_KOR"
	default n
	help
	Say Y here if you use A13_LTE grip firmware to separate for KOR.

config SENSORS_A96T396_BIRDIE
	depends on I2C
	tristate "for grip sensor firmware of birdie"
	default n
	help
	Say Y here if you use BIRDIE grip firmware.

config SENSORS_FW_VENDOR
	depends on I2C
	tristate "for grip sensor firmware in vendor"
	default n
	help
	Say Y here if you use firmware in vendor.

config SENSORS_CORE_AP
	tristate "Need to use Sensors core ap version"
	default n
	help
	  Say Y here if you using sensors_core.c included under drivers/sensors etc.

config SENSORS_A96T396_2CH
	depends on I2C
	tristate "SENSORS_A96T396_2CH driver for grip 2ch"
	default n
	help
	  Say Y here if you use model grip 2ch.

config SENSORS_A96T396_SUB_2CH
	depends on I2C
	tristate "SENSORS_A96T396_SUB_2CH driver for grip sub 2ch"
	default n
	help
	Say Y here if you use model grip_sub 2ch.

config SENSORS_DUMP_DATA
	tristate "Grip sensor dump log"
	default n
	help
	  Enable grip dump log data
	  This option activates log output of grip error data using sensordump_notifier.

config SENSORS_GRIP_FAILURE_DEBUG
	bool "Grip failure debug"
	help
	  Say Y here, Enable Grip failure debug flag.

config SENSORS_LOW_TEMP_COMP
	bool "Grip condition for low temperature"
	help
	  Say Y here, if you need low temperature compensation.

config SENSORS_SUPPORT_LOGIC_PARAMETER
	bool "support grip logic fw"
	help
	  Say Y here, if the model support logic firmware.
```
