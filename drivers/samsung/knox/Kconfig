## drivers/vision/npu/core/Kconfig
```kconfig
menuconfig EXYNOS_NPU
	tristate "Exynos NPU driver (Test)"
	depends on VISION_CORE
	help
		Exynos NPU Test device driver

menuconfig EXYNOS_NPU_CORE
	tristate "Exynos NPU driver (TEST)"
	depends on EXYNOS_NPU
	help
		Exynos NPU core device driver

menuconfig EXYNOS_NPU_DRAM_FW_LOG_BUF
	bool "DRAM buffer for firmware test and debugging"
	depends on EXYNOS_NPU
	default y
	help
		When this option is enabled, 1MB buffer will be reserved at the start of
		device virtual address space to support firmware test and debugging.

menuconfig EXYNOS_NPU_PUBLISH_NPU_BUILD_VER
	bool "Print out update log on initialization."
	depends on EXYNOS_NPU
	default y
	help
		When this option is enabled, last git log messages and stash information
		is printed on NPU initialization, to track source code update.

menuconfig EXYNOS_NPU_DEBUG_SRAM_DUMP
	bool "SRAM dump interface"
	depends on EXYNOS_NPU
	default n
	help
		When this option is enabled, SRAM dump file is created on debugfs
		and the SRAM can be dumpted.

menuconfig EXYNOS_NPU_EXPOSE_KERNEL_ADDR
	bool "Expose kernel address value in log message"
	depends on EXYNOS_NPU
	default n
	help
		When this option is enabled, all kernel address logging is
		changed to %p instead of %pK, so the value will be visible without
		setting kptr_restrict. Enabling this option is dangerous and
		THIS OPTION MUST BE DISABLED ON PRODUCTION BINARY.

config NPU_FW_HEADER_FILE
	bool "use NPU.bin as header file for GKI"
	default n
	help
		Can`t include Firmware binary to boot.image on GKI. So, we need
		header file to use frimware.

config NPU_STM
	bool "use STM for debugging"
	depends on CORESIGHT_STM
	default n
	help
		This feature need to analyze npu complier.

config NPU_USE_FENCE_SYNC
	bool "use fence sync"
	default n
	help
		This feature enables fence service in device driver and FW.

config NPU_USE_ASYNC
	bool "use async"
	default n
	help
		This feature enables async execution in device driver.

config NPU_STM_NEED_BUSP_DIV
	bool "Need BUSP div on STM mode"
	depends on NPU_STM
	default n
	help
		If need to busp div ratio, this feature should be enable

if EXYNOS_NPU

config NPU_ZEBU_EMULATION
bool
default n

config NPU_GOLDEN_MATCH
bool
default n

config NPU_ZEBU_SYSMMU
bool
default y

config FIRMWARE_SRAM_DUMP_DEBUGFS
bool
default y

source "drivers/vision/npu/core/interface/Kconfig"

config NPU_USE_MBR
	bool "use Master Boot Record for FW booting"
	default n
	help
		Because of lack of memory allocation by remapper limitation,
		use Master Boot Record for FW booting.

config NPU_PERF_FW
	bool "use performance firmware"
	default n
	help
		Because of performance test,
		use performance firmware for test.

config NPU_SCHEDULER_GOVERNOR
	bool "use scheduler and governor for power/performance control for NPU"
	depends on EXYNOS_NPU
	default y
	help
		use scheduler and governor for power/performance control for NPU

		When this option is enabled, additional module is activated for
		power / performance control for NPU HW.
		Also governor is needed to be selected for scheduler.

config NPU_GOVERNOR_SIMPLE_EXYNOS
	bool "use simple-exynos governor policy for NPU scheduler"
	depends on NPU_SCHEDULER_GOVERNOR
	default y
	help
		use simple-exynos governor policy for NPU scheduler

		Also governor is needed to be selected for NPU scheduler.
		Simple-exynos governor selects NPU-related frequecies in
		gradual manner by thresholds.

config NPU_GOVERNOR_EXYNOS_INTERACTIVE
	bool "use exynos-interactive governor policy for NPU scheduler"
	depends on NPU_SCHEDULER_GOVERNOR
	default y
	help
		use exynos-interactive governor policy for NPU scheduler

		Also governor is needed to be selected for NPU scheduler.
		Exynos-interactive governor selects NPU-related frequecies in
		gradual manner by thresholds.
		Also introduce hispeed/lowspeed ramp up.

config NPU_GOVERNOR_USERSPACE
	bool "use userspace governor policy for NPU scheduler"
	depends on NPU_SCHEDULER_GOVERNOR
	default y
	help
		Also governor is needed to be selected for NPU scheduler.
		Userspace governor directly selects NPU-related frequecies as
		preferred frequency not related to load.

config NPU_USE_SPROFILER
	bool "use S-profiler for debugging"
	default n
	help
		use S-profiler for debugging

		S-profiler for internal use

config NPU_USE_VOTF
	bool "use virtual-OTF function"
	default n
	help
		use virtual-OTF function

		vOTF for internal use

config NPU_ARBITRATION
	bool "enable NPU core arbitration support"
	default n
	help
		When this option is enabled, the NPU core arbitration
		algorithm monitors the workload and allows some of the
		NPU cores to be turned OFF for power saving.

		NPU core arbitration for internal use

config NPU_CORE_DRIVER
	bool "enable NPU core driver support"
	default n
	help
		When this option is enabled, we can control NPU cores.

config NPU_USE_AFM
	bool "use AFM feature"
	default n
	help
		This feature support hw thrott.

config NPU_USE_MAILBOX_GROUP
	bool "use group in mailbox"
	default y
	help
		This feature can support mailbox group in mailbox.

config NPU_USE_HW_DEVICE
	bool "use hw-device platform driver"
	default n
	help
		This feature can support additional function to control HW device module
		which is defined as individual module inside of NPU/DSP IP.
		This module can represent individual control of CPU, MIF or INT to support
		NPU-related controls.

config NPU_USE_BOOT_IOCTL
	bool "use BOOT IOCTL"
	depends on NPU_USE_HW_DEVICE
	default n
	help
		This feature can support BOOT IOCTL which divides OPEN sequence as two stage,
		one is session assignment (OPEN IOCTL) and another is power control and
		initial settings (BOOT IOCTL).
		This feature needs 'HW DEVICE' platform device driver to control each HW modules.

config DSP_USE_VS4L
	bool "support DSP functionality with VS4L"
	default n
	help
		This feature can support DSP functionality with VS4L.
		This feature includes DL (Dynamic Loading).

config NPU_USE_S2MPU_NAME_IS_NPUS
	bool "name of NPU S2MPU is NPUS"
	default n
	help
		This feature can support name of NPU S2MPU is NPUS. Default name is DNC.

config NPU_USE_LLC
	bool "LLC"
	default n
	help
		TODO

config NPU_USE_IMB_ALLOCATOR
	bool "use CHUNK-IMB allocator"
	default n
	help
		use CHUNK-IMB allocator

		CHUNK-IMB allocator for memory management of intermediate buffer.
		Host used to allocate the memory for an intermediate buffer in the past,
		but the owner of intermediate buffer allocation should be changed to NPU firmware because
		the several requests with unbounded property, which are issued from the same network,
		should be able to be processed on all NPU cores in terms of hardware utilization.
		Therefore NPU firmware should be able to allocate a different intermediate buffer on runtime,
		and host doesn't have to allocate memory for intermediate buffer more.

config NPU_USE_LLC_PRESET
	bool "PRESET mode can set LLC size"
	default n
	help
		This feature can support set LLC size on preset

config NPU_NCP_VERSION
	int "NPU NCP Version"
	range 21 25
	default 25
	help
		NPU NCP Version

config NPU_NUM_CORES
	int "NPU NUM Cores"
	range 1 4
	default 2
	help
		NPU NUM Cores

config NPU_USE_UTIL_STATS
	bool "NPU UTIL STATS"
	default n
	help
		Use utilization of HW for exynos stats

config NPU_USE_PI_DTM
	bool "use PI_DTM"
	default n
	help
		use PI_DTM for NPU thermal

config NPU_SET_DNC_FREQ
	bool "set DNC_FREQ"
	default n
	help
		set DNC_FREQ for preset

config NPU_IMB_THRESHOLD
	bool "IMB threshold size"
	default n
	help
		Move allocation point using this

endif
```

## drivers/vision/npu/core/interface/Kconfig
```kconfig
config NPU_INTERFACE
	bool "Select Interface"
	help
	  This is NPU interface

config NPU_LOOPBACK
	bool "Use Loopback"
	depends on NPU_INTERFACE
	help
	  This is loopback device

config NPU_HARDWARE
	bool "Use Hardware"
	depends on NPU_INTERFACE
	help
	  This is hardware device

config NPU_MAILBOX_VERSION
	int "NPU Mailbox Version"
	range 4 9
	default 7
	help
	  NPU Mailbox Version

config NPU_COMMAND_VERSION
	int "NPU Command Version"
	range 7 10
	default 8
	help
	  NPU Command Version
```

## drivers/vision3/Kconfig
```kconfig
menuconfig VISION_SUPPORT3
	tristate "Vision Support"
	select VISION_CORE
	help
	  If you want to use hardware acceleration for vision
	  enable this option and other options below.

if VISION_SUPPORT3

source "drivers/vision3/vision-core/Kconfig"

source "drivers/vision3/dsp/Kconfig"

source "drivers/vision3/npu/Kconfig"

endif # VISION_SUPPORT
```
