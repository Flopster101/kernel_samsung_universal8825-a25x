/*
 * s2mf301 battery device tree common
 *
 * Copyright (c) 2022 Samsung Electronics Co., Ltd.
 *		http://www.samsung.com
 *
 * This program is free software; you can redistribute it and/or modify
 * it under the terms of the GNU General Public License version 2 as
 * published by the Free Software Foundation.
 */

&smd {
	s2mf301_fuelgauge: s2mf301-fuelgauge {
		status = "okay";
		fuelgauge,capacity_full = <5000>;
		fuelgauge,low_voltage_limit_lowtemp = <3100>;
		fuelgauge,fuel_alert_soc = <1>;
		fuelgauge,capacity_max = <1000>;
		fuelgauge,capacity_max_margin = <200>;
		fuelgauge,capacity_min = <0>;
		fuelgauge,capacity_calculation_type = <28>;
		fuelgauge,use_external_temp;
#if 1
		fuelgauge,bat_id_gpio = <
				SEC_GPIO_REF(PM,s2mpu16_gpio,gpio_s,5) 0  /* BAT_ID_2 */
				SEC_GPIO_REF(PM,s2mpu16_gpio,gpio_s,4) 0  /* BAT_ID_1 */
				>;
#endif
	};
};

&smd {
	battery {
		battery,fgsrc_switch_name = "s2mf301-fuelgauge"; /* Fuelgauge voltage source */
	};
};


/* /home/dpi/qb5_8815/workspace/P4_1716/android/kernel/kmodule/battery/suwon/fuelgauge/s2mf301/a55x/s2mf301_fuelgauge.dtsi */
/*
 * s2mf301 battery device tree common
 *
 * Copyright (c) 2023 Samsung Electronics Co., Ltd.
 *		http://www.samsung.com
 *
 * This program is free software; you can redistribute it and/or modify
 * it under the terms of the GNU General Public License version 2 as
 * published by the Free Software Foundation.
 */

&smd {
	s2mf301_fuelgauge: s2mf301-fuelgauge {
		status = "okay";
		fuelgauge,capacity_full = <5000>;
		fuelgauge,low_voltage_limit_lowtemp = <3100>;
		fuelgauge,low_voltage_limit = <3350>;
		fuelgauge,fuel_alert_soc = <1>;
		fuelgauge,capacity_max = <1000>;
		fuelgauge,capacity_max_margin = <200>;
		fuelgauge,capacity_min = <0>;
		fuelgauge,capacity_calculation_type = <28>;
		fuelgauge,use_external_temp;
#if 1
		fuelgauge,bat_id_gpio = <
				SEC_GPIO_REF(PM,s2mpu16_gpio,gpio_s,5) 0  /* BAT_ID_2 */
				SEC_GPIO_REF(PM,s2mpu16_gpio,gpio_s,4) 0  /* BAT_ID_1 */
				>;
#endif
	};
};

&smd {
	battery {
		battery,fgsrc_switch_name = "s2mf301-fuelgauge"; /* Fuelgauge voltage source */
	};
};

&smd {
	s2mf301_battery_params: battery_params {
	/*
	 * BAT_ID_1/BAT_ID_2
	 * 01: ATL_safe, 00: ATL_safe
	 * 10: ATL_safe, 11: SDI
	 */

	/* 11: SDI */
		battery3,battery_data = <
			/***** battery data for 4.45 *****/
			/* battery,battery_table3 */
			89 11 230 10 117 10 252 9 130 9
			12 9 158 8 56 8 219 7 104 7
			11 7 208 6 160 6 122 6 89 6
			48 6 255 5 206 5 142 5 121 5
			86 3 56 1 0 8 155 7 54 7
			208 6 107 6 6 6 161 5 60 5
			214 4 113 4 12 4 167 3 66 3
			221 2 119 2 18 2 173 1 72 1
			227 0 125 0 24 0 252 15

			/* battery,battery_table4 */
			14 14 14 14 27 27 27 27 27 27
			27 27 28 28 28 28 28 28 28 28
			26 154

			/* battery,batcap */
			0xa0 0x4d 0x95 0xd /* [0x0E] [0x0F] [0x10] [0x11] */

			/* battery,designcap */
			0xa0 0x4d /* [0x86~0x87] */

			/* battery,batcap_ocv_new */
			0xa1 0x4d /* 0x90~0x91 */

			/* battery,soc_arr_val */
			10000 9506 9012 8518 8023 7529 7035 6541 6047 5553
			5059 4565 4071 3577 3083 2589 2095 1600 1106 612
			118 (-19)

			/* battery,ocv_arr_val */
			44184 43621 43072 42480 41885 41310 40774 40275 39821 39256
			38803 38513 38281 38094 37937 37733 37495 37255 36945 36840
			34170 31525

			/* battery,rRS_CC0 */
			0x14 /* [0x5C] */

			/***** battery data for 4.43 *****/
			/* battery,battery_table3 */
			89 11 230 10 117 10 252 9 130 9
			12 9 158 8 56 8 219 7 104 7
			11 7 208 6 160 6 122 6 89 6
			48 6 255 5 206 5 142 5 121 5
			86 3 56 1 34 8 187 7 84 7
			237 6 134 6 31 6 184 5 82 5
			235 4 132 4 29 4 182 3 79 3
			233 2 130 2 27 2 180 1 77 1
			230 0 127 0 25 0 252 15

			/* battery,battery_table4 */
			14 14 14 14 27 27 27 27 27 27
			27 27 28 28 28 28 28 28 28 28
			26 154

			/* battery,batcap */
			0x60 0x4c 0x5d 0xd /* [0x0E] [0x0F] [0x10] [0x11] */

			/* battery,designcap */
			0x60 0x4c /* [0x86~0x87] */

			/* battery,batcap_ocv_new */
			0x61 0x4c /* 0x90~0x91 */

			/* battery,soc_arr_val */
			10164 9661 9159 8657 8155 7653 7150 6648 6146 5644
			5142 4640 4138 3635 3133 2631 2129 1627 1124 622
			120 (-20)

			/* battery,ocv_arr_val */
			44184 43621 43072 42480 41885 41310 40774 40275 39821 39256
			38803 38513 38281 38094 37937 37733 37495 37255 36945 36840
			34170 31525

			/* battery,rRS_CC0 */
			0x14 /* [0x5C] */

			/***** battery data for 4.41 *****/
			/* battery,battery_table3 */
			89 11 230 10 117 10 252 9 130 9
			12 9 158 8 56 8 219 7 104 7
			11 7 208 6 160 6 122 6 89 6
			48 6 255 5 206 5 142 5 121 5
			86 3 56 1 75 8 226 7 121 7
			16 7 167 6 62 6 213 5 109 5
			4 5 155 4 50 4 201 3 96 3
			247 2 142 2 38 2 189 1 84 1
			235 0 130 0 25 0 252 15

			/* battery,battery_table4 */
			14 14 14 14 27 27 27 27 27 27
			27 27 28 28 28 28 28 28 28 28
			26 154

			/* battery,batcap */
			0xe4 0x4a 0x1b 0xd  /* [0x0E] [0x0F] [0x10] [0x11] */

			/* battery,designcap */
			0xe4 0x4a /* [0x86~0x87] */

			/* battery,batcap_ocv_new */
			0xe5 0x4a /* 0x90~0x91 */

			/* battery,soc_arr_val */
			10365 9853 9341 8829 8316 7804 7292 6780 6268 5756
			5243 4732 4220 3708 3195 2683 2171 1659 1147 635
			122 (-20)

			/* battery,ocv_arr_val */
			44184 43621 43072 42480 41885 41310 40774 40275 39821 39256
			38803 38513 38281 38094 37937 37733 37495 37255 36945 36840
			34170 31525

			/* battery,rRS_CC0 */
			0x14 /* [0x5C] */

			/***** battery data for 4.39 *****/
			/* battery,battery_table3 */
			89 11 230 10 117 10 252 9 130 9
			12 9 158 8 56 8 219 7 104 7
			11 7 208 6 160 6 122 6 89 6
			48 6 255 5 206 5 142 5 121 5
			86 3 56 1 118 8 11 8 160 7
			53 7 201 6 94 6 243 5 136 5
			29 5 178 4 71 4 220 3 113 3
			6 3 155 2 48 2 197 1 90 1
			239 0 131 0 24 0 251 15

			/* battery,battery_table4 */
			14 14 14 14 27 27 27 27 27 27
			27 27 28 28 28 28 28 28 28 28
			26 154

			/* battery,batcap */
			0x5c 0x49 0xd6 0xc /* [0x0E] [0x0F] [0x10] [0x11] */

			/* battery,designcap */
			0x5c 0x49 /* [0x86~0x87] */

			/* battery,batcap_ocv_new */
			0x5d 0x49 /* 0x90~0x91 */

			/* battery,soc_arr_val */
			10575 10052 9529 9007 8484 7961 7438 6915 6392 5870
			5347 4824 4302 3779 3256 2733 2210 1688 1165 642
			119 (-26)

			/* battery,ocv_arr_val */
			44184 43621 43072 42480 41885 41310 40774 40275 39821 39256
			38803 38513 38281 38094 37937 37733 37495 37255 36945 36840
			34170 31525

			/* battery,rRS_CC0 */
			0x14 /* [0x5C] */

			/***** battery data for 4.34 *****/
			/* battery,battery_table3 */
			89 11 230 10 117 10 252 9 130 9
			12 9 158 8 56 8 219 7 104 7
			11 7 208 6 160 6 122 6 89 6
			48 6 255 5 206 5 142 5 121 5
			86 3 56 1 214 8 102 8 246 7
			135 7 23 7 167 6 55 6 200 5
			88 5 232 4 120 4 9 4 153 3
			41 3 185 2 74 2 218 1 106 1
			250 0 138 0 27 0 252 15

			/* battery,battery_table4 */
			14 14 14 14 14 27 27 27 27 27
			27 27 28 28 28 28 28 28 28 28
			26 154

			/* battery,batcap */
			0x48 0x46 0x4c 0xc /* [0x0E] [0x0F] [0x10] [0x11] */

			/* battery,designcap */
			0x48 0x46 /* [0x86~0x87] */

			/* battery,batcap_ocv_new */
			0x49 0x46 /* 0x90~0x91 */

			/* battery,soc_arr_val */
			11045 10499 9953 9408 8862 8316 7770 7225 6679 6133
			5587 5042 4496 3951 3405 2859 2313 1768 1222 676
			130 (-21)

			/* battery,ocv_arr_val */
			44184 43621 43072 42480 41885 41310 40774 40275 39821 39256
			38803 38513 38281 38094 37937 37733 37495 37255 36945 36840
			34170 31525

			/* battery,rRS_CC0 */
			0x14 /* [0x5C] */

			>;
	/* 10: ATL_safe */
		battery2,battery_data = <
			/***** battery data for 4.45 *****/
			/* battery,battery_table3 */
			97 11 243 10 135 10 16 10 150 9
			33 9 178 8 76 8 241 7 142 7
			28 7 222 6 174 6 134 6 102 6
			67 6 17 6 233 5 170 5 138 5
			211 4 234 0 0 8 156 7 57 7
			213 6 113 6 13 6 170 5 70 5
			226 4 127 4 27 4 183 3 84 3
			240 2 140 2 40 2 197 1 97 1
			253 0 153 0 54 0 236 15

			/* battery,battery_table4 */
			12 12 12 12 25 25 25 25 25 25
			25 25 25 25 25 25 25 25 25 25
			25 154

			/* battery,batcap */
			0x08 0x50 0x01 0x0c /* [0x0E] [0x0F] [0x10] [0x11] */

			/* battery,designcap */
			0xdc 0x4e /* [0x86~0x87] */

			/* battery,batcap_ocv_new */
			0xdd 0x4e /* 0x90~0x91 */

			/* battery,soc_arr_val */
			10000 9514 9027 8540 8053 7566 7079 6592 6106 5619
			5132 4645 4158 3671 3184 2697 2210 1723 1236 749
			262 (-97)

			/* battery,ocv_arr_val */
			44223 43688 43157 42577 41984 41410 40868 40370 39925 39444
			38886 38585 38347 38154 37999 37827 37583 37389 37082 36923
			36031 31141

			/* battery,rRS_CC0 */
			0x12 /* [0x5C] */

			/***** battery data for 4.43 *****/
			/* battery,battery_table3 */
			97 11 243 10 135 10 16 10 150 9
			33 9 178 8 76 8 241 7 142 7
			28 7 222 6 174 6 134 6 102 6
			67 6 17 6 233 5 170 5 138 5
			211 4 234 0 38 8 192 7 91 7
			245 6 143 6 42 6 196 5 95 5
			249 4 148 4 46 4 201 3 99 3
			254 2 152 2 50 2 205 1 103 1
			2 1 156 0 55 0 236 15

			/* battery,battery_table4 */
			12 12 12 12 25 25 25 25 25 25
			25 25 25 25 25 25 25 25 25 25
			25 154

			/* battery,batcap */
			0x70 0x4d 0x8d 0xd /* [0x0E] [0x0F] [0x10] [0x11] */

			/* battery,designcap */
			0x70 0x4d /* [0x86~0x87] */

			/* battery,batcap_ocv_new */
			0x71 0x4d /* 0x90~0x91 */

			/* battery,soc_arr_val */
			10183 9688 9192 8696 8201 7705 7209 6713 6218 5722
			5226 4730 4234 3738 3242 2747 2251 1755 1259 763
			267 (-99)

			/* battery,ocv_arr_val */
			44223 43688 43157 42577 41984 41410 40868 40370 39925 39444
			38886 38585 38347 38154 37999 37827 37583 37389 37082 36923
			36031 31141

			/* battery,rRS_CC0 */
			0x12 /* [0x5C] */

			/***** battery data for 4.41 *****/
			/* battery,battery_table3 */
			97 11 243 10 135 10 16 10 150 9
			33 9 178 8 76 8 241 7 142 7
			28 7 222 6 174 6 134 6 102 6
			67 6 17 6 233 5 170 5 138 5
			211 4 234 0 81 8 233 7 130 7
			26 7 178 6 75 6 227 5 123 5
			20 5 172 4 69 4 221 3 117 3
			14 3 166 2 62 2 215 1 111 1
			7 1 160 0 56 0 235 15

			/* battery,battery_table4 */
			12 12 12 12 25 25 25 25 25 25
			25 25 25 25 25 25 25 25 25 25
			25 154

			/* battery,batcap */
			0xdc 0x4b 0x46 0xd /* [0x0E] [0x0F] [0x10] [0x11] */

			/* battery,designcap */
			0xdc 0x4b /* [0x86~0x87] */

			/* battery,batcap_ocv_new */
			0xdd 0x4b /* 0x90~0x91 */

			/* battery,soc_arr_val */
			10395 9890 9383 8877 8371 7865 7359 6853 6347 5841
			5335 4828 4322 3816 3310 2804 2298 1791 1285 779
			273 (-101)

			/* battery,ocv_arr_val */
			44223 43688 43157 42577 41984 41410 40868 40370 39925 39444
			38886 38585 38347 38154 37999 37827 37583 37389 37082 36923
			36031 31141

			/* battery,rRS_CC0 */
			0x12 /* [0x5C] */

			/***** battery data for 4.39 *****/
			/* battery,battery_table3 */
			97 11 243 10 135 10 16 10 150 9
			33 9 178 8 76 8 241 7 142 7
			28 7 222 6 174 6 134 6 102 6
			67 6 17 6 233 5 170 5 138 5
			211 4 234 0 129 8 23 8 173 7
			67 7 217 6 110 6 4 6 154 5
			48 5 198 4 92 4 242 3 136 3
			30 3 180 2 74 2 224 1 118 1
			12 1 162 0 56 0 234 15

			/* battery,battery_table4 */
			12 12 12 12 12 25 25 25 25 25
			25 25 25 25 25 25 25 25 25 25
			25 154

			/* battery,batcap */
			0x28 0x4a 0xfa 0xc /* [0x0E] [0x0F] [0x10] [0x11] */

			/* battery,designcap */
			0x28 0x4a /* [0x86~0x87] */

			/* battery,batcap_ocv_new */
			0x29 0x4a /* 0x90~0x91 */

			/* battery,soc_arr_val */
			10628 10111 9593 9075 8557 8039 7522 7004 6487 5969
			5451 4933 4416 3898 3380 2862 2344 1827 1309 791
			273 (-109)

			/* battery,ocv_arr_val */
			44223 43688 43157 42577 41984 41410 40868 40370 39925 39444
			38886 38585 38347 38154 37999 37827 37583 37389 37082 36923
			36031 31141

			/* battery,rRS_CC0 */
			0x12 /* [0x5C] */

			/***** battery data for 4.34 *****/
			/* battery,battery_table3 */
			97 11 243 10 135 10 16 10 150 9
			33 9 178 8 76 8 241 7 142 7
			28 7 222 6 174 6 134 6 102 6
			67 6 17 6 233 5 170 5 138 5
			211 4 234 0 223 8 112 8 2 8
			147 7 37 7 182 6 71 6 217 5
			106 5 252 4 141 4 31 4 176 3
			66 3 211 2 100 2 246 1 135 1
			25 1 170 0 60 0 234 15

			/* battery,battery_table4 */
			12 12 12 12 12 25 25 25 25 25
			25 25 25 25 25 25 25 25 25 25
			25 154

			/* battery,batcap */
			0x20 0x47 0x72 0xc /* [0x0E] [0x0F] [0x10] [0x11] */

			/* battery,designcap */
			0x20 0x47 /* [0x86~0x87] */

			/* battery,batcap_ocv_new */
			0x21 0x47 /* 0x90~0x91 */

			/* battery,soc_arr_val */
			11087 10548 10008 9468 8928 8389 7849 7309 6769 6230
			5690 5150 4610 4070 3530 2990 2450 1911 1371 831
			291 (-108)

			/* battery,ocv_arr_val */
			44223 43688 43157 42577 41984 41410 40868 40370 39925 39444
			38886 38585 38347 38154 37999 37827 37583 37389 37082 36923
			36031 31141

			/* battery,rRS_CC0 */
			0x12 /* [0x5C] */

			>;
	/* 01: ATL_safe */
		battery1,battery_data = <
			/***** battery data for 4.45 *****/
			/* battery,battery_table3 */
			97 11 243 10 135 10 16 10 150 9
			33 9 178 8 76 8 241 7 142 7
			28 7 222 6 174 6 134 6 102 6
			67 6 17 6 233 5 170 5 138 5
			211 4 234 0 0 8 156 7 57 7
			213 6 113 6 13 6 170 5 70 5
			226 4 127 4 27 4 183 3 84 3
			240 2 140 2 40 2 197 1 97 1
			253 0 153 0 54 0 236 15

			/* battery,battery_table4 */
			12 12 12 12 25 25 25 25 25 25
			25 25 25 25 25 25 25 25 25 25
			25 154

			/* battery,batcap */
			0x08 0x50 0x01 0x0c /* [0x0E] [0x0F] [0x10] [0x11] */

			/* battery,designcap */
			0xdc 0x4e /* [0x86~0x87] */

			/* battery,batcap_ocv_new */
			0xdd 0x4e /* 0x90~0x91 */

			/* battery,soc_arr_val */
			10000 9514 9027 8540 8053 7566 7079 6592 6106 5619
			5132 4645 4158 3671 3184 2697 2210 1723 1236 749
			262 (-97)

			/* battery,ocv_arr_val */
			44223 43688 43157 42577 41984 41410 40868 40370 39925 39444
			38886 38585 38347 38154 37999 37827 37583 37389 37082 36923
			36031 31141

			/* battery,rRS_CC0 */
			0x12 /* [0x5C] */

			/***** battery data for 4.43 *****/
			/* battery,battery_table3 */
			97 11 243 10 135 10 16 10 150 9
			33 9 178 8 76 8 241 7 142 7
			28 7 222 6 174 6 134 6 102 6
			67 6 17 6 233 5 170 5 138 5
			211 4 234 0 38 8 192 7 91 7
			245 6 143 6 42 6 196 5 95 5
			249 4 148 4 46 4 201 3 99 3
			254 2 152 2 50 2 205 1 103 1
			2 1 156 0 55 0 236 15

			/* battery,battery_table4 */
			12 12 12 12 25 25 25 25 25 25
			25 25 25 25 25 25 25 25 25 25
			25 154

			/* battery,batcap */
			0x70 0x4d 0x8d 0xd /* [0x0E] [0x0F] [0x10] [0x11] */

			/* battery,designcap */
			0x70 0x4d /* [0x86~0x87] */

			/* battery,batcap_ocv_new */
			0x71 0x4d /* 0x90~0x91 */

			/* battery,soc_arr_val */
			10183 9688 9192 8696 8201 7705 7209 6713 6218 5722
			5226 4730 4234 3738 3242 2747 2251 1755 1259 763
			267 (-99)

			/* battery,ocv_arr_val */
			44223 43688 43157 42577 41984 41410 40868 40370 39925 39444
			38886 38585 38347 38154 37999 37827 37583 37389 37082 36923
			36031 31141

			/* battery,rRS_CC0 */
			0x12 /* [0x5C] */

			/***** battery data for 4.41 *****/
			/* battery,battery_table3 */
			97 11 243 10 135 10 16 10 150 9
			33 9 178 8 76 8 241 7 142 7
			28 7 222 6 174 6 134 6 102 6
			67 6 17 6 233 5 170 5 138 5
			211 4 234 0 81 8 233 7 130 7
			26 7 178 6 75 6 227 5 123 5
			20 5 172 4 69 4 221 3 117 3
			14 3 166 2 62 2 215 1 111 1
			7 1 160 0 56 0 235 15

			/* battery,battery_table4 */
			12 12 12 12 25 25 25 25 25 25
			25 25 25 25 25 25 25 25 25 25
			25 154

			/* battery,batcap */
			0xdc 0x4b 0x46 0xd /* [0x0E] [0x0F] [0x10] [0x11] */

			/* battery,designcap */
			0xdc 0x4b /* [0x86~0x87] */

			/* battery,batcap_ocv_new */
			0xdd 0x4b /* 0x90~0x91 */

			/* battery,soc_arr_val */
			10395 9890 9383 8877 8371 7865 7359 6853 6347 5841
			5335 4828 4322 3816 3310 2804 2298 1791 1285 779
			273 (-101)

			/* battery,ocv_arr_val */
			44223 43688 43157 42577 41984 41410 40868 40370 39925 39444
			38886 38585 38347 38154 37999 37827 37583 37389 37082 36923
			36031 31141

			/* battery,rRS_CC0 */
			0x12 /* [0x5C] */

			/***** battery data for 4.39 *****/
			/* battery,battery_table3 */
			97 11 243 10 135 10 16 10 150 9
			33 9 178 8 76 8 241 7 142 7
			28 7 222 6 174 6 134 6 102 6
			67 6 17 6 233 5 170 5 138 5
			211 4 234 0 129 8 23 8 173 7
			67 7 217 6 110 6 4 6 154 5
			48 5 198 4 92 4 242 3 136 3
			30 3 180 2 74 2 224 1 118 1
			12 1 162 0 56 0 234 15

			/* battery,battery_table4 */
			12 12 12 12 12 25 25 25 25 25
			25 25 25 25 25 25 25 25 25 25
			25 154

			/* battery,batcap */
			0x28 0x4a 0xfa 0xc /* [0x0E] [0x0F] [0x10] [0x11] */

			/* battery,designcap */
			0x28 0x4a /* [0x86~0x87] */

			/* battery,batcap_ocv_new */
			0x29 0x4a /* 0x90~0x91 */

			/* battery,soc_arr_val */
			10628 10111 9593 9075 8557 8039 7522 7004 6487 5969
			5451 4933 4416 3898 3380 2862 2344 1827 1309 791
			273 (-109)

			/* battery,ocv_arr_val */
			44223 43688 43157 42577 41984 41410 40868 40370 39925 39444
			38886 38585 38347 38154 37999 37827 37583 37389 37082 36923
			36031 31141

			/* battery,rRS_CC0 */
			0x12 /* [0x5C] */

			/***** battery data for 4.34 *****/
			/* battery,battery_table3 */
			97 11 243 10 135 10 16 10 150 9
			33 9 178 8 76 8 241 7 142 7
			28 7 222 6 174 6 134 6 102 6
			67 6 17 6 233 5 170 5 138 5
			211 4 234 0 223 8 112 8 2 8
			147 7 37 7 182 6 71 6 217 5
			106 5 252 4 141 4 31 4 176 3
			66 3 211 2 100 2 246 1 135 1
			25 1 170 0 60 0 234 15

			/* battery,battery_table4 */
			12 12 12 12 12 25 25 25 25 25
			25 25 25 25 25 25 25 25 25 25
			25 154

			/* battery,batcap */
			0x20 0x47 0x72 0xc /* [0x0E] [0x0F] [0x10] [0x11] */

			/* battery,designcap */
			0x20 0x47 /* [0x86~0x87] */

			/* battery,batcap_ocv_new */
			0x21 0x47 /* 0x90~0x91 */

			/* battery,soc_arr_val */
			11087 10548 10008 9468 8928 8389 7849 7309 6769 6230
			5690 5150 4610 4070 3530 2990 2450 1911 1371 831
			291 (-108)

			/* battery,ocv_arr_val */
			44223 43688 43157 42577 41984 41410 40868 40370 39925 39444
			38886 38585 38347 38154 37999 37827 37583 37389 37082 36923
			36031 31141

			/* battery,rRS_CC0 */
			0x12 /* [0x5C] */

			>;
	/* 00: ATL_safe */
		battery0,battery_data = <
			/***** battery data for 4.45 *****/
			/* battery,battery_table3 */
			97 11 243 10 135 10 16 10 150 9
			33 9 178 8 76 8 241 7 142 7
			28 7 222 6 174 6 134 6 102 6
			67 6 17 6 233 5 170 5 138 5
			211 4 234 0 0 8 156 7 57 7
			213 6 113 6 13 6 170 5 70 5
			226 4 127 4 27 4 183 3 84 3
			240 2 140 2 40 2 197 1 97 1
			253 0 153 0 54 0 236 15

			/* battery,battery_table4 */
			12 12 12 12 25 25 25 25 25 25
			25 25 25 25 25 25 25 25 25 25
			25 154

			/* battery,batcap */
			0x08 0x50 0x01 0x0c /* [0x0E] [0x0F] [0x10] [0x11] */

			/* battery,designcap */
			0xdc 0x4e /* [0x86~0x87] */

			/* battery,batcap_ocv_new */
			0xdd 0x4e /* 0x90~0x91 */

			/* battery,soc_arr_val */
			10000 9514 9027 8540 8053 7566 7079 6592 6106 5619
			5132 4645 4158 3671 3184 2697 2210 1723 1236 749
			262 (-97)

			/* battery,ocv_arr_val */
			44223 43688 43157 42577 41984 41410 40868 40370 39925 39444
			38886 38585 38347 38154 37999 37827 37583 37389 37082 36923
			36031 31141

			/* battery,rRS_CC0 */
			0x12 /* [0x5C] */

			/***** battery data for 4.43 *****/
			/* battery,battery_table3 */
			97 11 243 10 135 10 16 10 150 9
			33 9 178 8 76 8 241 7 142 7
			28 7 222 6 174 6 134 6 102 6
			67 6 17 6 233 5 170 5 138 5
			211 4 234 0 38 8 192 7 91 7
			245 6 143 6 42 6 196 5 95 5
			249 4 148 4 46 4 201 3 99 3
			254 2 152 2 50 2 205 1 103 1
			2 1 156 0 55 0 236 15

			/* battery,battery_table4 */
			12 12 12 12 25 25 25 25 25 25
			25 25 25 25 25 25 25 25 25 25
			25 154

			/* battery,batcap */
			0x70 0x4d 0x8d 0xd /* [0x0E] [0x0F] [0x10] [0x11] */

			/* battery,designcap */
			0x70 0x4d /* [0x86~0x87] */

			/* battery,batcap_ocv_new */
			0x71 0x4d /* 0x90~0x91 */

			/* battery,soc_arr_val */
			10183 9688 9192 8696 8201 7705 7209 6713 6218 5722
			5226 4730 4234 3738 3242 2747 2251 1755 1259 763
			267 (-99)

			/* battery,ocv_arr_val */
			44223 43688 43157 42577 41984 41410 40868 40370 39925 39444
			38886 38585 38347 38154 37999 37827 37583 37389 37082 36923
			36031 31141

			/* battery,rRS_CC0 */
			0x12 /* [0x5C] */

			/***** battery data for 4.41 *****/
			/* battery,battery_table3 */
			97 11 243 10 135 10 16 10 150 9
			33 9 178 8 76 8 241 7 142 7
			28 7 222 6 174 6 134 6 102 6
			67 6 17 6 233 5 170 5 138 5
			211 4 234 0 81 8 233 7 130 7
			26 7 178 6 75 6 227 5 123 5
			20 5 172 4 69 4 221 3 117 3
			14 3 166 2 62 2 215 1 111 1
			7 1 160 0 56 0 235 15

			/* battery,battery_table4 */
			12 12 12 12 25 25 25 25 25 25
			25 25 25 25 25 25 25 25 25 25
			25 154

			/* battery,batcap */
			0xdc 0x4b 0x46 0xd /* [0x0E] [0x0F] [0x10] [0x11] */

			/* battery,designcap */
			0xdc 0x4b /* [0x86~0x87] */

			/* battery,batcap_ocv_new */
			0xdd 0x4b /* 0x90~0x91 */

			/* battery,soc_arr_val */
			10395 9890 9383 8877 8371 7865 7359 6853 6347 5841
			5335 4828 4322 3816 3310 2804 2298 1791 1285 779
			273 (-101)

			/* battery,ocv_arr_val */
			44223 43688 43157 42577 41984 41410 40868 40370 39925 39444
			38886 38585 38347 38154 37999 37827 37583 37389 37082 36923
			36031 31141

			/* battery,rRS_CC0 */
			0x12 /* [0x5C] */

			/***** battery data for 4.39 *****/
			/* battery,battery_table3 */
			97 11 243 10 135 10 16 10 150 9
			33 9 178 8 76 8 241 7 142 7
			28 7 222 6 174 6 134 6 102 6
			67 6 17 6 233 5 170 5 138 5
			211 4 234 0 129 8 23 8 173 7
			67 7 217 6 110 6 4 6 154 5
			48 5 198 4 92 4 242 3 136 3
			30 3 180 2 74 2 224 1 118 1
			12 1 162 0 56 0 234 15

			/* battery,battery_table4 */
			12 12 12 12 12 25 25 25 25 25
			25 25 25 25 25 25 25 25 25 25
			25 154

			/* battery,batcap */
			0x28 0x4a 0xfa 0xc /* [0x0E] [0x0F] [0x10] [0x11] */

			/* battery,designcap */
			0x28 0x4a /* [0x86~0x87] */

			/* battery,batcap_ocv_new */
			0x29 0x4a /* 0x90~0x91 */

			/* battery,soc_arr_val */
			10628 10111 9593 9075 8557 8039 7522 7004 6487 5969
			5451 4933 4416 3898 3380 2862 2344 1827 1309 791
			273 (-109)

			/* battery,ocv_arr_val */
			44223 43688 43157 42577 41984 41410 40868 40370 39925 39444
			38886 38585 38347 38154 37999 37827 37583 37389 37082 36923
			36031 31141

			/* battery,rRS_CC0 */
			0x12 /* [0x5C] */

			/***** battery data for 4.34 *****/
			/* battery,battery_table3 */
			97 11 243 10 135 10 16 10 150 9
			33 9 178 8 76 8 241 7 142 7
			28 7 222 6 174 6 134 6 102 6
			67 6 17 6 233 5 170 5 138 5
			211 4 234 0 223 8 112 8 2 8
			147 7 37 7 182 6 71 6 217 5
			106 5 252 4 141 4 31 4 176 3
			66 3 211 2 100 2 246 1 135 1
			25 1 170 0 60 0 234 15

			/* battery,battery_table4 */
			12 12 12 12 12 25 25 25 25 25
			25 25 25 25 25 25 25 25 25 25
			25 154

			/* battery,batcap */
			0x20 0x47 0x72 0xc /* [0x0E] [0x0F] [0x10] [0x11] */

			/* battery,designcap */
			0x20 0x47 /* [0x86~0x87] */

			/* battery,batcap_ocv_new */
			0x21 0x47 /* 0x90~0x91 */

			/* battery,soc_arr_val */
			11087 10548 10008 9468 8928 8389 7849 7309 6769 6230
			5690 5150 4610 4070 3530 2990 2450 1911 1371 831
			291 (-108)

			/* battery,ocv_arr_val */
			44223 43688 43157 42577 41984 41410 40868 40370 39925 39444
			38886 38585 38347 38154 37999 37827 37583 37389 37082 36923
			36031 31141

			/* battery,rRS_CC0 */
			0x12 /* [0x5C] */

			>;
	};
};
