## net/skb_tracer/Kconfig
```kconfig
# SPDX-License-Identifier: GPL-2.0-only
#
# skb_tracer configuration
#
config SKB_TRACER
	tristate "skb tracer"
	depends on NET
	select SKB_EXTENSIONS
	help
          skb tracer

config SKB_TRACER_TEST
	tristate "KUnit test for skb tracer"
	depends on SKB_TRACER
	help
	  test skb tracer
```

## security/samsung/mz/Kconfig
```kconfig
#
# MZ configuration
#

config MEMORY_ZEROISATION
	bool "Support memory zeroisation"
	default n
	help
      Support memory zeroisation feature which does zeroing of free pages.
      The purpose of this is to zeroise specific memory
      when target process exit.

config MZ_PAGE_V2
	bool "Page functions version"
	default n
	help
      MZ page management code have dependency on kernel.
      This version need to be change when kernel page code is changed.
```

## sound/soc/codecs/tfa9878/Kconfig
```kconfig
menu "Goodix TFA9878 amplifier configuration"

if SND_SOC_TFA9878
config TFA_STEREO_NODE
        bool "Stereo sysfs node support"
        help
          Extend sysfs nodes for stereo support.
          In application, it's necessary to differ nodes between channels.
          In mono case, it provides with 'NODE_NAME', and
          in stereo case, it provides 'NODE_NAME' for left and 'NODE_NAME'_r for right.

config PLATFORM_EXYNOS
        bool "Exynos platform support"
        default y
        help
          Enable compile options for Exynos platform.
          It adapts codec driver to the target platform.
          It encloses the options, used in codec driver, for Exynos platform.
          It differs the configuration between Exynos platform and the others.

endif # SND_SOC_TFA9878

endmenu
```

## sound/soc/samsung/Kconfig
```kconfig
# SPDX-License-Identifier: GPL-2.0-only
menuconfig SND_SOC_SAMSUNG
	tristate "ASoC support for Samsung"
	depends on PLAT_SAMSUNG || ARCH_S5PV210 || ARCH_EXYNOS || COMPILE_TEST
	depends on COMMON_CLK
	select SND_SOC_GENERIC_DMAENGINE_PCM
	help
	  Say Y or M if you want to add support for codecs attached to
	  the Samsung SoCs' Audio interfaces. You will also need to
	  select the audio interfaces to support below.

if SND_SOC_SAMSUNG

config SND_S3C24XX_I2S
	tristate

config SND_S3C_I2SV2_SOC
	tristate

config SND_S3C2412_SOC_I2S
	tristate
	select SND_S3C_I2SV2_SOC

config SND_SAMSUNG_PCM
	tristate "Samsung PCM interface support"

config SND_SAMSUNG_SPDIF
	tristate "Samsung SPDIF transmitter support"
	select SND_SOC_SPDIF

config SND_SAMSUNG_I2S
	tristate "Samsung I2S interface support"

config SND_SOC_SAMSUNG_DISPLAYPORT
	tristate "Samsung DISPLAYPORT Audio"
	help
	  Say Y if you want to use displayport audio.

config SND_SOC_SAMSUNG_NEO1973_WM8753
	tristate "Audio support for Openmoko Neo1973 Smartphones (GTA02)"
	depends on MACH_NEO1973_GTA02
	select SND_S3C24XX_I2S
	select SND_SOC_WM8753
	select SND_SOC_BT_SCO
	help
	  Say Y here to enable audio support for the Openmoko Neo1973
	  Smartphones.

config SND_SOC_SAMSUNG_JIVE_WM8750
	tristate "SoC I2S Audio support for Jive"
	depends on MACH_JIVE && I2C
	select SND_SOC_WM8750
	select SND_S3C2412_SOC_I2S
	help
	  Say Y if you want to add support for SoC audio on the Jive.

config SND_SOC_SAMSUNG_SMDK_WM8580
	tristate "SoC I2S Audio support for WM8580 on SMDK"
	depends on MACH_SMDK6410 || COMPILE_TEST
	depends on I2C
	select SND_SOC_WM8580
	select SND_SAMSUNG_I2S
	help
	  Say Y if you want to add support for SoC audio on the SMDKs.

config SND_SOC_SAMSUNG_SMDK_WM8994
	tristate "SoC I2S Audio support for WM8994 on SMDK"
	depends on I2C=y
	select MFD_WM8994
	select SND_SOC_WM8994
	select SND_SAMSUNG_I2S
	help
		Say Y if you want to add support for SoC audio on the SMDKs.

config SND_SOC_SAMSUNG_S3C24XX_UDA134X
	tristate "SoC I2S Audio support UDA134X wired to a S3C24XX"
	depends on ARCH_S3C24XX
	select SND_S3C24XX_I2S
	select SND_SOC_L3
	select SND_SOC_UDA134X

config SND_SOC_SAMSUNG_SIMTEC
	tristate
	help
	  Internal node for common S3C24XX/Simtec support.

config SND_SOC_SAMSUNG_SIMTEC_TLV320AIC23
	tristate "SoC I2S Audio support for TLV320AIC23 on Simtec boards"
	depends on ARCH_S3C24XX && I2C
	select SND_S3C24XX_I2S
	select SND_SOC_TLV320AIC23_I2C
	select SND_SOC_SAMSUNG_SIMTEC

config SND_SOC_SAMSUNG_SIMTEC_HERMES
	tristate "SoC I2S Audio support for Simtec Hermes board"
	depends on ARCH_S3C24XX && I2C
	select SND_S3C24XX_I2S
	select SND_SOC_TLV320AIC3X
	select SND_SOC_SAMSUNG_SIMTEC

config SND_SOC_SAMSUNG_H1940_UDA1380
	tristate "Audio support for the HP iPAQ H1940"
	depends on ARCH_H1940 && I2C
	select SND_S3C24XX_I2S
	select SND_SOC_UDA1380
	help
	  This driver provides audio support for HP iPAQ h1940 PDA.

config SND_SOC_SAMSUNG_RX1950_UDA1380
	tristate "Audio support for the HP iPAQ RX1950"
	depends on MACH_RX1950 && I2C
	select SND_S3C24XX_I2S
	select SND_SOC_UDA1380
	help
	  This driver provides audio support for HP iPAQ RX1950 PDA.

config SND_SOC_SMARTQ
	tristate "SoC I2S Audio support for SmartQ board"
	depends on MACH_SMARTQ || COMPILE_TEST
	depends on GPIOLIB || COMPILE_TEST
	depends on I2C
	select SND_SAMSUNG_I2S
	select SND_SOC_WM8750

config SND_SOC_SAMSUNG_SMDK_SPDIF
	tristate "SoC S/PDIF Audio support for SMDK"
	select SND_SAMSUNG_SPDIF
	help
	  Say Y if you want to add support for SoC S/PDIF audio on the SMDK.

config SND_SOC_SMDK_WM8994_PCM
	tristate "SoC PCM Audio support for WM8994 on SMDK"
	depends on I2C=y
	select MFD_WM8994
	select SND_SOC_WM8994
	select SND_SAMSUNG_PCM
	help
	  Say Y if you want to add support for SoC audio on the SMDK

config SND_SOC_SPEYSIDE
	tristate "Audio support for Wolfson Speyside"
	depends on I2C && SPI_MASTER
	depends on MACH_WLF_CRAGG_6410 || COMPILE_TEST
	select SND_SAMSUNG_I2S
	select SND_SOC_WM8996
	select SND_SOC_WM9081
	select SND_SOC_WM0010
	select SND_SOC_WM1250_EV1

config SND_SOC_TOBERMORY
	tristate "Audio support for Wolfson Tobermory"
	depends on INPUT && I2C
	depends on MACH_WLF_CRAGG_6410 || COMPILE_TEST
	select SND_SAMSUNG_I2S
	select SND_SOC_WM8962

config SND_SOC_BELLS
	tristate "Audio support for Wolfson Bells"
	depends on MFD_ARIZONA && MFD_WM5102 && MFD_WM5110 && I2C && SPI_MASTER
	depends on MACH_WLF_CRAGG_6410 || COMPILE_TEST
	select SND_SAMSUNG_I2S
	select SND_SOC_WM5102
	select SND_SOC_WM5110
	select SND_SOC_WM9081
	select SND_SOC_WM0010
	select SND_SOC_WM1250_EV1

config SND_SOC_LOWLAND
	tristate "Audio support for Wolfson Lowland"
	depends on I2C
	depends on MACH_WLF_CRAGG_6410 || COMPILE_TEST
	select SND_SAMSUNG_I2S
	select SND_SOC_WM5100
	select SND_SOC_WM9081

config SND_SOC_LITTLEMILL
	tristate "Audio support for Wolfson Littlemill"
	depends on I2C
	depends on MACH_WLF_CRAGG_6410 || COMPILE_TEST
	select SND_SAMSUNG_I2S
	select MFD_WM8994
	select SND_SOC_WM8994

config SND_SOC_SNOW
	tristate "Audio support for Google Snow boards"
	depends on I2C
	select SND_SOC_MAX98090
	select SND_SOC_MAX98095
	select SND_SAMSUNG_I2S
	help
	  Say Y if you want to add audio support for various Snow
	  boards based on Exynos5 series of SoCs.

config SND_SOC_ODROID
	tristate "Audio support for Odroid XU3/XU4"
	depends on SND_SOC_SAMSUNG && I2C
	select SND_SOC_MAX98090
	select SND_SAMSUNG_I2S
	help
	  Say Y here to enable audio support for the Odroid XU3/XU4.

config SND_SOC_SAMSUNG_EXYNOS8825_S5M3700X_I2C
	tristate "S5M3700X support on exynos8825 with i2c bus"
	select SND_SOC_S5M3700X
	select SND_SOC_S5M3700X_DUMP
	select SND_SOC_S5M3700X_VTS
	select SND_SOC_S5M3700X_HIFI

config SND_SOC_SAMSUNG_EXYNOS_TFA9874
	tristate "TFA9874 amp support on exynos"
	select SND_SOC_TFA9874
	select FW_LOADER_USER_HELPER
	select FW_LOADER_USER_HELPER_FALLBACK

config SND_SOC_SAMSUNG_EXYNOS_TFA9878
	tristate "TFA9878 amp support on exynos"
	select SND_SOC_TFA9878
	select FW_LOADER_USER_HELPER
	select FW_LOADER_USER_HELPER_FALLBACK
	select SEC_SND_SYNCHRONIZED_IPC

config SND_SOC_SAMSUNG_EXYNOS_TAS2562
	tristate "TAS2562 amp support on exynos"
	select SND_SOC_TAS2562
	select SEC_SND_ADAPTATION

config SND_SOC_SAMSUNG_EXYNOS_CS35L41_I2C
	tristate "CS35L41 support on exynos with i2c bus"
	select SND_SOC_CS35L41_I2C
	select MFD_CS35L41_I2C

config SND_SOC_SAMSUNG_EXYNOS_CS47L92_SPI
	tristate "CS47L92 support on exynos with spi bus"
	select SND_SOC_CS47L92
	select MFD_MADERA
	select MFD_MADERA_SPI
	select MFD_CS47L92
	select MFD_ARIZONA
	select REGULATOR_ARIZONA_LDO1
	select REGULATOR_ARIZONA_MICSUPP
	select EXTCON
	select EXTCON_MADERA
	select EXTCON_MADERA_INPUT_EVENT
	select GPIO_MADERA

config SND_SOC_SAMSUNG_EXYNOS9925_SOUND
	tristate "Sound card support on exynos9925"
	select SND_SOC_SAMSUNG_ABOX
	select SND_SOC_SAMSUNG_VTS
	select SND_SOC_SAMSUNG_MAILBOX
	select SND_SOC_SAMSUNG_SLIF
	select SND_SOC_SAMSUNG_DISPLAYPORT

config SND_SOC_SAMSUNG_EXYNOS8825_SOUND
	tristate "Sound card support on exynos8825"
	select SND_SOC_SAMSUNG_ABOX
	select SND_SOC_SAMSUNG_MAILBOX
	select SND_SOC_SAMSUNG_VTS
	select SND_SOC_SAMSUNG_SLIF

config SND_SOC_SAMSUNG_EXYNOS8825_AUDIO
	tristate "Sound card support on exynos8825"
	select SND_SOC_SAMSUNG_ABOX
	select SND_SOC_SAMSUNG_MAILBOX
	select SND_SOC_SAMSUNG_VTS
	select SND_SOC_SAMSUNG_SLIF

config SND_SOC_SAMSUNG_EXYNOS8825_RT5665
	tristate "RT5665 codec support on exynos8825"
	select SND_SOC_SAMSUNG_ABOX
	select SND_SOC_SAMSUNG_MAILBOX
	select SND_SOC_SAMSUNG_VTS
	select SND_SOC_SAMSUNG_SLIF
	select SND_SOC_RT5665

config SND_SOC_SAMSUNG_EXYNOS8825_RT5665_DBMDX
	tristate "RT5665 codec support on exynos8825"
	select SND_SOC_SAMSUNG_ABOX
	#select SND_SOC_SAMSUNG_MAILBOX
	#select SND_SOC_SAMSUNG_VTS
	#select SND_SOC_SAMSUNG_SLIF
	select SND_SOC_RT5665

config SND_SOC_SAMSUNG_EXYNOS8825_RT5691
	tristate "RT5691 codec support on exynos8825"
	select SND_SOC_SAMSUNG_ABOX
	select SND_SOC_SAMSUNG_MAILBOX
	select SND_SOC_SAMSUNG_VTS
	select SND_SOC_SAMSUNG_SLIF
	select SND_SOC_RT5691

config SND_SOC_SAMSUNG_RAINBOW_PRINCE
	tristate "Prince AMP support on exynos9925"
	select SND_SOC_SAMSUNG_ABOX
	select SND_SOC_SAMSUNG_VTS
	select SND_SOC_SAMSUNG_MAILBOX
	select SND_SOC_SAMSUNG_SLIF
	select SND_SOC_SAMSUNG_DISPLAYPORT

config SND_SOC_ARNDALE
	tristate "Audio support for Arndale Board"
	depends on I2C
	select SND_SAMSUNG_I2S
	select SND_SOC_RT5631
	select MFD_WM8994
	select SND_SOC_WM8994

config SND_SOC_SAMSUNG_TM2_WM5110
	tristate "SoC I2S Audio support for WM5110 on TM2 board"
	depends on SND_SOC_SAMSUNG && MFD_ARIZONA && MFD_WM5110 && I2C && SPI_MASTER
	depends on GPIOLIB || COMPILE_TEST
	select SND_SOC_MAX98504
	select SND_SOC_WM5110
	select SND_SAMSUNG_I2S
	help
	  Say Y if you want to add support for SoC audio on the TM2 board.

config SND_SOC_SAMSUNG_ARIES_WM8994
	tristate "SoC I2S Audio support for WM8994 on Aries"
	depends on SND_SOC_SAMSUNG && MFD_WM8994 && IIO && EXTCON
	select SND_SOC_BT_SCO
	select SND_SOC_WM8994
	select SND_SAMSUNG_I2S
	help
	  Say Y if you want to add support for SoC audio on Aries boards,
	  which has a WM8994 codec connected to a BT codec, a cellular
	  modem, and the Samsung I2S controller.  Jack detection is done
	  via ADC, GPIOs, and an extcon device.  Switching between the Mic
	  and TV-Out path is also handled.

config SND_SOC_SAMSUNG_MIDAS_WM1811
	tristate "SoC I2S Audio support for Midas boards"
	depends on SND_SOC_SAMSUNG
	select SND_SAMSUNG_I2S
	select SND_SOC_WM8994
	help
	  Say Y if you want to add support for SoC audio on the Midas boards.

config SND_SOC_SAMSUNG_AUDIO
	tristate "Audio support for Samsung Projects"
	help
	  Say Y here to enable audio support for the Samsung Audio.

source "sound/soc/samsung/abox/Kconfig"
source "sound/soc/samsung/vts/Kconfig"
source "sound/soc/samsung/slif/Kconfig"

endif #SND_SOC_SAMSUNG
```

## sound/soc/samsung/slif/Kconfig
```kconfig
config SND_SOC_SAMSUNG_SLIF
	tristate "Samsung Serial LIF"
	help
	  Say Y if you want to use Serial LIF.

config SND_SOC_SAMSUNG_SLIF_VERSION
	hex "VTS Serial LIF IP version"
	depends on SND_SOC_SAMSUNG_SLIF
	default 0x10000 if SOC_EXYNOS9830_EVT0
	default 0x10101 if SOC_EXYNOS9830
	default 0x10102 if SOC_EXYNOS2100_EVT0
	default 0x10101 if SOC_EXYNOS2100
	default 0x10102 if SOC_S5E9925
	default 0x10101 if SOC_S5E8825
	help
	  Version of Serial LIF IP.
	  Value = 0x10000 * major + 0x100 * minor + rev.
	  Ex. 1.00 rev0 => 0x10000, 1.01 rev1 => 0x10101
```

## sound/soc/samsung/vts/Kconfig
```kconfig
config SND_SOC_SAMSUNG_MAILBOX
	tristate "Samsung MAILBOX"
	help
	  Say Y if you want to use mailbox for voice trigger system.

config SND_SOC_SAMSUNG_VTS
	tristate "Samsung VTS"
	depends on SND_SOC_SAMSUNG_MAILBOX
	help
	  Say Y if you want to use voice trigger system.

config SND_SOC_SAMSUNG_VTS_VERSION
	hex "VTS version"
	depends on SND_SOC_SAMSUNG_VTS
	default 0x10000 if SOC_EXYNOS2100
	default 0x20000 if SOC_S5E9925
	default 0x20100 if SOC_S5E8825
	help
	  Version of VTS.
	  Value = 0x10000 * major + 0x100 * minor + rev.
	  Ex. 1.00 rev0 => 0x10000, 1.01 rev1 => 0x10101

config SND_SOC_SAMSUNG_VTS_V1
	bool
	depends on SND_SOC_SAMSUNG_VTS
	default y if SND_SOC_SAMSUNG_VTS_VERSION < 0x20000
	default n if SND_SOC_SAMSUNG_VTS_VERSION >= 0x20000

config SND_SOC_SAMSUNG_VTS_V2
	bool
	depends on SND_SOC_SAMSUNG_VTS
	default n if SND_SOC_SAMSUNG_VTS_VERSION < 0x20000
	default y if SND_SOC_SAMSUNG_VTS_VERSION >= 0x20000 \
		&& SND_SOC_SAMSUNG_VTS_VERSION < 0x20100

config SND_SOC_SAMSUNG_VTS_V2_1
	bool
	depends on SND_SOC_SAMSUNG_VTS
	default n if SND_SOC_SAMSUNG_VTS_VERSION < 0x20100
	default y if SND_SOC_SAMSUNG_VTS_VERSION >= 0x20100 \
		&& SND_SOC_SAMSUNG_VTS_VERSION < 0x30000
```

## test/Kconfig
```kconfig
#
# KUnit base configuration
#

menu "KUnit support"

config SEC_KUNIT
	bool "Enable support for unit tests (KUnit)"
	select HAS_IOMEM
	help
	  Enables support for kernel unit tests (KUnit), a lightweight unit
	  testing and mocking framework for the Linux kernel. These tests are
	  able to be run locally on a developer's workstation without a VM or
	  special hardware. For more information, please see Documentation/test/

if SEC_KUNIT

config SEC_KUNIT_TEST
	bool "KUnit test for KUnit"
	depends on SEC_KUNIT
	default n
	help
	  Enables KUnit test to test KUnit.

config SEC_KUNIT_DEATH_TEST
	bool "(Expert) KUnit death test for KUnit"
	depends on SEC_KUNIT
	default n
	help
	  Enables KUnit test to test KUnit death test feature. This test is not
	  hermetic and can cause other tests to misbehave.

config SEC_EXAMPLE_TEST
	bool "Example test for KUnit"
	depends on SEC_KUNIT
	default n
	help
	  Enables example KUnit test to demo features of KUnit.

config SEC_KUNIT_MANAGER
	tristate "Manager for KUnit"
	depends on SEC_KUNIT
	depends on !UML
	default m
	help
	  Enables KUnit Manager.

config KUNIT_USE_UPSTREAM_NAMES
	bool "(transitional) start using upstream names for types/functions"
	default n
	depends on KUNIT
	help
	  Changes names of KUnit types/functions to match the upstream version of KUnit.
endif # SEC_KUNIT

endmenu
```
