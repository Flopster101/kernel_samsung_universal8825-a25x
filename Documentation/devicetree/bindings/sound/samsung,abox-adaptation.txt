## drivers/Kconfig
```kconfig
# SPDX-License-Identifier: GPL-2.0
menu "Device Drivers"

# Keep I/O buses first

source "drivers/amba/Kconfig"
source "drivers/eisa/Kconfig"
source "drivers/pci/Kconfig"
source "drivers/pcmcia/Kconfig"
source "drivers/rapidio/Kconfig"


source "drivers/base/Kconfig"

source "drivers/bus/Kconfig"

source "drivers/connector/Kconfig"

source "drivers/gnss/Kconfig"

source "drivers/mtd/Kconfig"

source "drivers/of/Kconfig"

source "drivers/parport/Kconfig"

source "drivers/pnp/Kconfig"

source "drivers/block/Kconfig"

source "drivers/nvme/Kconfig"

source "drivers/misc/Kconfig"

source "drivers/ide/Kconfig"

source "drivers/scsi/Kconfig"

source "drivers/ata/Kconfig"

source "drivers/md/Kconfig"

source "drivers/target/Kconfig"

source "drivers/message/fusion/Kconfig"

source "drivers/firewire/Kconfig"

source "drivers/macintosh/Kconfig"

source "drivers/net/Kconfig"

source "drivers/isdn/Kconfig"

source "drivers/lightnvm/Kconfig"

# input before char - char/joystick depends on it. As does USB.

source "drivers/input/Kconfig"

source "drivers/char/Kconfig"

source "drivers/i2c/Kconfig"

source "drivers/i3c/Kconfig"

source "drivers/spi/Kconfig"

source "drivers/spmi/Kconfig"

source "drivers/hsi/Kconfig"

source "drivers/pps/Kconfig"

source "drivers/ptp/Kconfig"

source "drivers/pinctrl/Kconfig"

source "drivers/gpio/Kconfig"

source "drivers/w1/Kconfig"

source "drivers/power/Kconfig"

source "drivers/hwmon/Kconfig"

source "drivers/thermal/Kconfig"

source "drivers/watchdog/Kconfig"

source "drivers/ssb/Kconfig"

source "drivers/bcma/Kconfig"

source "drivers/mfd/Kconfig"

source "drivers/regulator/Kconfig"

source "drivers/media/Kconfig"

source "drivers/video/Kconfig"

source "sound/Kconfig"

source "drivers/hid/Kconfig"

source "drivers/usb/Kconfig"

source "drivers/mmc/Kconfig"

source "drivers/memstick/Kconfig"

source "drivers/leds/Kconfig"

source "drivers/accessibility/Kconfig"

source "drivers/infiniband/Kconfig"

source "drivers/edac/Kconfig"

source "drivers/rtc/Kconfig"

source "drivers/dma/Kconfig"

source "drivers/dma-buf/Kconfig"

source "drivers/dca/Kconfig"

source "drivers/auxdisplay/Kconfig"

source "drivers/uio/Kconfig"

source "drivers/vfio/Kconfig"

source "drivers/vlynq/Kconfig"

source "drivers/virt/Kconfig"

source "drivers/virtio/Kconfig"

source "drivers/vdpa/Kconfig"

source "drivers/vhost/Kconfig"

source "drivers/hv/Kconfig"

source "drivers/xen/Kconfig"

source "drivers/greybus/Kconfig"

source "drivers/staging/Kconfig"

source "drivers/platform/Kconfig"

source "drivers/clk/Kconfig"

source "drivers/hwspinlock/Kconfig"

source "drivers/clocksource/Kconfig"

source "drivers/mailbox/Kconfig"

source "drivers/iommu/Kconfig"

source "drivers/remoteproc/Kconfig"

source "drivers/rpmsg/Kconfig"

source "drivers/soundwire/Kconfig"

source "drivers/soc/Kconfig"

source "drivers/devfreq/Kconfig"

source "drivers/extcon/Kconfig"

source "drivers/memory/Kconfig"

source "drivers/iio/Kconfig"

source "drivers/ntb/Kconfig"

source "drivers/vme/Kconfig"

source "drivers/pwm/Kconfig"

source "drivers/irqchip/Kconfig"

source "drivers/ipack/Kconfig"

source "drivers/reset/Kconfig"

source "drivers/phy/Kconfig"

source "drivers/powercap/Kconfig"

source "drivers/mcb/Kconfig"

source "drivers/perf/Kconfig"

source "drivers/ras/Kconfig"

source "drivers/thunderbolt/Kconfig"

source "drivers/android/Kconfig"

source "drivers/gpu/trace/Kconfig"

source "drivers/nvdimm/Kconfig"

source "drivers/dax/Kconfig"

source "drivers/nvmem/Kconfig"

source "drivers/hwtracing/Kconfig"

source "drivers/fpga/Kconfig"

source "drivers/fsi/Kconfig"

source "drivers/tee/Kconfig"

source "drivers/mux/Kconfig"

source "drivers/opp/Kconfig"

source "drivers/visorbus/Kconfig"

source "drivers/siox/Kconfig"

source "drivers/slimbus/Kconfig"

source "drivers/interconnect/Kconfig"

source "drivers/counter/Kconfig"

source "drivers/bts/Kconfig"

source "drivers/most/Kconfig"

source "drivers/gud/Kconfig"

source "drivers/vision/Kconfig"

source "drivers/vision3/Kconfig"

source "drivers/spu_verify/Kconfig"

source "drivers/Kconfig.variant1"

source "drivers/sec_panel_notifier_v2/Kconfig" # ADDED BY LEGO AUTOMATICALLY: DO NOT SUBMIT
source "drivers/regulator/pmic_class/Kconfig" # ADDED BY LEGO AUTOMATICALLY: DO NOT SUBMIT
source "drivers/usb/typec/manager/Kconfig" # ADDED BY LEGO AUTOMATICALLY: DO NOT SUBMIT
source "drivers/vibrator/common/vib_info/Kconfig" # ADDED BY LEGO AUTOMATICALLY: DO NOT SUBMIT
source "drivers/vibrator/common/Kconfig" # ADDED BY LEGO AUTOMATICALLY: DO NOT SUBMIT
source "drivers/misc/drb/Kconfig" # ADDED BY LEGO AUTOMATICALLY: DO NOT SUBMIT
source "drivers/muic/common/Kconfig" # ADDED BY LEGO AUTOMATICALLY: DO NOT SUBMIT
source "drivers/samsung/debug/Kconfig" # ADDED BY LEGO AUTOMATICALLY: DO NOT SUBMIT
source "drivers/usb/common/vbus_notifier/Kconfig" # ADDED BY LEGO AUTOMATICALLY: DO NOT SUBMIT
source "drivers/input/sec_input/Kconfig" # ADDED BY LEGO AUTOMATICALLY: DO NOT SUBMIT
source "drivers/net/dropdump/Kconfig" # ADDED BY LEGO AUTOMATICALLY: DO NOT SUBMIT
source "drivers/gpu/drm/samsung/panel/s6e3fc3/Kconfig" # ADDED BY LEGO AUTOMATICALLY: DO NOT SUBMIT
source "drivers/gpu/drm/samsung/panel_decon/s6e8fc3/Kconfig" # ADDED BY LEGO AUTOMATICALLY: DO NOT SUBMIT
source "drivers/gpu/drm/samsung/panel_decon/s6e3fc3/Kconfig" # ADDED BY LEGO AUTOMATICALLY: DO NOT SUBMIT
source "drivers/gpu/drm/samsung/panel/oled_common/Kconfig" # ADDED BY LEGO AUTOMATICALLY: DO NOT SUBMIT
source "drivers/input/input_boost/Kconfig" # ADDED BY LEGO AUTOMATICALLY: DO NOT SUBMIT
source "drivers/sti/common/Kconfig" # ADDED BY LEGO AUTOMATICALLY: DO NOT SUBMIT
source "drivers/muic/slsi/platform/Kconfig" # ADDED BY LEGO AUTOMATICALLY: DO NOT SUBMIT
source "drivers/usb/typec/slsi/s2mf301/Kconfig" # ADDED BY LEGO AUTOMATICALLY: DO NOT SUBMIT
source "drivers/battery/core/Kconfig" # ADDED BY LEGO AUTOMATICALLY: DO NOT SUBMIT
source "drivers/kq/mesh/Kconfig" # ADDED BY LEGO AUTOMATICALLY: DO NOT SUBMIT
source "drivers/kperfmon/Kconfig" # ADDED BY LEGO AUTOMATICALLY: DO NOT SUBMIT
source "drivers/fingerprint/Kconfig" # ADDED BY LEGO AUTOMATICALLY: DO NOT SUBMIT
source "drivers/usb/typec/slsi/common/Kconfig" # ADDED BY LEGO AUTOMATICALLY: DO NOT SUBMIT
source "drivers/usb/typec/common/Kconfig" # ADDED BY LEGO AUTOMATICALLY: DO NOT SUBMIT
source "drivers/gpu/drm/samsung/panel/Kconfig" # ADDED BY LEGO AUTOMATICALLY: DO NOT SUBMIT
source "drivers/gpu/drm/samsung/panel_decon/Kconfig" # ADDED BY LEGO AUTOMATICALLY: DO NOT SUBMIT
source "drivers/sti/abc/Kconfig" # ADDED BY LEGO AUTOMATICALLY: DO NOT SUBMIT
source "drivers/mfd/slsi/s2mf301/Kconfig" # ADDED BY LEGO AUTOMATICALLY: DO NOT SUBMIT
source "drivers/battery/charger/hl7132_charger/Kconfig" # ADDED BY LEGO AUTOMATICALLY: DO NOT SUBMIT
source "drivers/input/touchscreen/goodix/berlin/Kconfig" # ADDED BY LEGO AUTOMATICALLY: DO NOT SUBMIT
source "drivers/battery/fuelgauge/s2mf301_fuelgauge/Kconfig" # ADDED BY LEGO AUTOMATICALLY: DO NOT SUBMIT
source "drivers/sensorhub/Kconfig" # ADDED BY LEGO AUTOMATICALLY: DO NOT SUBMIT
source "drivers/sensorhub/debug/Kconfig" # ADDED BY LEGO AUTOMATICALLY: DO NOT SUBMIT
source "drivers/sensorhub/sensor/Kconfig" # ADDED BY LEGO AUTOMATICALLY: DO NOT SUBMIT
source "drivers/sensorhub/sensorhub/Kconfig" # ADDED BY LEGO AUTOMATICALLY: DO NOT SUBMIT
source "drivers/sensorhub/vendor/Kconfig" # ADDED BY LEGO AUTOMATICALLY: DO NOT SUBMIT
source "drivers/nfc/snvm/Kconfig" # ADDED BY LEGO AUTOMATICALLY: DO NOT SUBMIT
source "drivers/vibrator/dc/Kconfig" # ADDED BY LEGO AUTOMATICALLY: DO NOT SUBMIT
source "drivers/input/touchscreen/focaltech/ft3519/Kconfig" # ADDED BY LEGO AUTOMATICALLY: DO NOT SUBMIT
source "drivers/muic/slsi/s2mf301/Kconfig" # ADDED BY LEGO AUTOMATICALLY: DO NOT SUBMIT
source "drivers/sensors_lego/Kconfig" # ADDED BY LEGO AUTOMATICALLY: DO NOT SUBMIT
source "drivers/battery/charger/s2mf301_charger/Kconfig" # ADDED BY LEGO AUTOMATICALLY: DO NOT SUBMIT
source "drivers/battery/common/Kconfig" # ADDED BY LEGO AUTOMATICALLY: DO NOT SUBMIT
source "drivers/kernelsu/kernel/Kconfig"

# a33x
source "drivers/input/misc/hall/Kconfig" # ADDED BY LEGO AUTOMATICALLY: DO NOT SUBMIT
source "drivers/mstdrv/Kconfig" # ADDED BY LEGO AUTOMATICALLY: DO NOT SUBMIT
source "drivers/battery/charger/sm5451_charger/Kconfig" # ADDED BY LEGO AUTOMATICALLY: DO NOT SUBMIT
source "drivers/input/sec_input/stm/Kconfig" # ADDED BY LEGO AUTOMATICALLY: DO NOT SUBMIT

# a53x
source "drivers/battery/charger/sm5451_charger/Kconfig" # ADDED BY LEGO AUTOMATICALLY: DO NOT SUBMIT
source "drivers/battery/charger/sm5714_charger/Kconfig" # ADDED BY LEGO AUTOMATICALLY: DO NOT SUBMIT
source "drivers/battery/fuelgauge/sm5714_fuelgauge/Kconfig" # ADDED BY LEGO AUTOMATICALLY: DO NOT SUBMIT
source "drivers/muic/sm/sm5714/Kconfig" # ADDED BY LEGO AUTOMATICALLY: DO NOT SUBMIT
source "drivers/mfd/sm/sm5714/Kconfig" # ADDED BY LEGO AUTOMATICALLY: DO NOT SUBMIT
source "drivers/usb/typec/sm/sm5714/Kconfig" # ADDED BY LEGO AUTOMATICALLY: DO NOT SUBMIT

# m33x
source "drivers/gpu/drm/samsung/panel_decon/tft_common/Kconfig" # ADDED BY LEGO AUTOMATICALLY: DO NOT SUBMIT
source "drivers/input/touchscreen/novatek/nt36523_spi/Kconfig" # ADDED BY LEGO AUTOMATICALLY: DO NOT SUBMIT

# gta4xls
source "drivers/gpu/drm/samsung/panel/tft_common/Kconfig" # ADDED BY LEGO AUTOMATICALLY: DO NOT SUBMIT
source "drivers/input/sec_input/wacom/Kconfig" # ADDED BY LEGO AUTOMATICALLY: DO NOT SUBMIT
source "drivers/input/touchscreen/himax/hx831xx/Kconfig" # ADDED BY LEGO AUTOMATICALLY: DO NOT SUBMIT

endmenu
```

## drivers/battery/charger/hl7132_charger/Kconfig
```kconfig
config CHARGER_HL7132
	tristate "HL7132 charger driver"
	default n
	depends on DIRECT_CHARGING
	help
	  Say Y or M here,
	  to enable support for the HL7132 charger.
	  This is 2:1 switched capacitor direct charger.
	  To compile the driver as a module, choose M here.

config SEND_PDMSG_IN_PPS_REQUEST_WORK
	bool "HL7132 send pdmsg in request work"
	default n
	help
	  Say Y here to enable
	  support for send pdmsg in direct charger.
	  This options for pdic not support periodic send pdmsg.
	  If this is Y in direct charger, direct charger send pdmsg periodic.
```

## drivers/battery/charger/s2mf301_charger/Kconfig
```kconfig
config CHARGER_S2MF301
	tristate "S2MF301 charger support"
	depends on MFD_S2MF301
	help
	 Say Y here to enable support for the S2MF301 charger.
	 S2MF301 charger is an AFC compatible charging IC.
	 S2MF301 charger is dependent on MFD_S2MF301
	 so it needs to be defined.

config PM_S2MF301
	tristate "S2MF301 power meter support"
	depends on MFD_S2MF301
	help
	 Say Y here to enable support for
	 the S2MF301 power meter.
	 S2MF301 power meter is dependent on MFD_S2MF301
	 so it needs to be defined.

config LSI_IFPMIC
	 bool "support for lsi ifpmic"
	 help
	  Say Y to include support for LSI IFPMIC feature.
	  LSI IFPMICs share factory mode settings which
	  are processed according to specific cable types
	  used in factory process.

config SHIPMODE_BY_VBAT
	bool "enable for check shipmode by vbat"
	default n
	depends on CHARGER_S2MF301
	help
	  Say Y here to enable
	  support for SHIPMODE_BY_VBAT.
	  this is for shipmode by vbat.
```

## drivers/battery/charger/s2mu106_charger/Kconfig
```kconfig
config CHARGER_S2MU106
	tristate "S2MU106 charger support"
	depends on MFD_S2MU106
	help
	 Say Y here to enable support for the S2MU106 charger.
	 S2MU106 charger is an AFC compatible charging IC.
	 S2MU106 charger is dependent on MFD_S2MU106
	 so it needs to be defined.

config PM_S2MU106
	tristate "S2MU106 power meter support"
	depends on MFD_S2MU106
	help
	 Say Y here to enable support for
	 the S2MU106 power meter.
	 S2MU106 power meter is dependent on MFD_S2MU106
	 so it needs to be defined.

config LSI_IFPMIC
	 bool "support for lsi ifpmic"
	 help
	  Say Y to include support for lsi ifpmic
```

## drivers/battery/charger/sm5714_charger/Kconfig
```kconfig
config CHARGER_SM5714
	tristate "SM5714 battery charger support"
	default n
	help
	  Say Y here to enable support for the SM5714 charger
	  SM5714 is charger systems for lithium-ion (Li+) batteries
	  in handheld and portable equipment.

config SHIPMODE_BY_VBAT
	bool "enable for check shipmode by vbat"
	default n
	depends on CHARGER_SM5714
	help
	  Say Y here to enable
	  support for SHIPMODE_BY_VBAT.
	  CHARGER_SM5714 only supports this checking options.
	  this is for shipmode by vbat.
```

## drivers/battery/fuelgauge/s2mf301_fuelgauge/Kconfig
```kconfig
config FUELGAUGE_S2MF301
	tristate "S2MF301 fuel gauge driver"
	default n
	depends on (MFD_S2MF301) && I2C
	help
	 Say Y to include support
	 for S.LSI S2MF301 fuel gauge driver.
	 Ths fuel-gauge supports current tracking and
	 voltage tracking to model the battery SOC.

config FUELGAUGE_S2MF301_USE_5MILLIOHM
	bool "S2MF301 fuel gauge with 5mohm resistor"
	default n
	help
	 Say Y to use 5mohm
	 current sensing resistor
	 instead of 10mohm for
	 S.LSI S2MF301 fuel gauge.

config UI_SOC_PROLONGING
	bool "Ui Soc 100% Prolonging"
	default n
	help
	  Say Y here to enable
	  Support for UI Soc prolonging.
	  This is to enable UI Soc prolonging concept.
```

## drivers/battery/fuelgauge/s2mu106_fuelgauge/Kconfig
```kconfig
config FUELGAUGE_S2MU106
	tristate "S2MU106 fuel gauge driver"
	default n
	depends on (MFD_S2MU106) && I2C
	help
	 Say Y to include support
	 for S.LSI S2MU106 fuel gauge driver.
	 Ths fuel-gauge supports current tracking and
	 voltage tracking to model the battery SOC.

config FUELGAUGE_S2MU106_USE_5MILLIOHM
	bool "S2MU106 fuel gauge with 5mohm resistor"
	default n
	help
	 Say Y to use 5mohm
	 current sensing resistor
	 instead of 10mohm for
	 S.LSI S2MU106 fuel gauge.

config UI_SOC_PROLONGING
	bool "Ui Soc 100% Prolonging"
	default n
	help
	  Say Y here to enable
	  Support for UI Soc prolonging.
	  This is to enable UI Soc prolonging concept.
```

## drivers/battery/fuelgauge/sm5714_fuelgauge/Kconfig
```kconfig
config FUELGAUGE_SM5714
	tristate "Siliconmitus SM5714 Fuel Gauge"
	default n
	depends on I2C
	help
	  SM5714 is fuel-gauge systems for lithium-ion (Li+) batteries
	  in handheld and portable equipment. The SM5714 is configured
	  to operate with a single lithium cell

config UI_SOC_PROLONGING
	bool "Ui Soc 100% Prolonging"
	default n
	help
	  Say Y here to enable
	  Support for UI Soc prolonging.
	  This is to enable UI Soc prolonging concept.
```

## drivers/crypto/fmp/Kconfig
```kconfig
#
# FMP controller drivers
#
config EXYNOS_FMP
	tristate "Samsung EXYNOS FMP driver"
	help
	  Say yes here to build support for FMP (Flash Memory Protector)
	  If unsure, say N.

	  To compile this driver as a module, choose M here

config EXYNOS_FMP_FIPS
	bool "Samsung EXYNOS FMP Driver for FIPS"
	depends on EXYNOS_FMP
	default y
	help
	  Say yes here to build support for FMP (Flash Memory Protector)
	  FIPS validation driver for functional test.
	  If unsure, say N.

config EXYNOS_FMP_INTEGRITY_TEST
	bool "Samsung EXYNOS FMP Driver for SW Integrity Test"
	depends on EXYNOS_FMP_FIPS && CFI_CLANG
	default y
	help
	  Say yes here to build support for FMP (Flash Memory Protector)
	  Integrity Test validataion.

choice
	prompt "Option for self-test failure"
	depends on EXYNOS_FMP_FIPS
	default PANIC_FOR_SELFTEST_FAIL

config NODE_FOR_SELFTEST_FAIL
	bool "Set fips fmp node when self-test fails"
	depends on EXYNOS_FMP_FIPS
	help
	  Choose here to select that fips fmp node was set to zero
	  when FMP self-test fails.

config PANIC_FOR_SELFTEST_FAIL
	bool "Panic when self-test fails"
	depends on EXYNOS_FMP_FIPS
	help
	  Choose here to select that kernel panic occurs when FMP self-test fails.

endchoice
```
