## Documentation/devicetree/bindings/sound/samsung,abox-adaptation.txt
```
Sample client driver of ABOX IP

This is sample driver using IPC of ABOX driver.

Required properties:

- compatible : "samsung,abox-adaptation".

- abox : phandle to abox device.

Optional properties: no optional property.
```

## Documentation/devicetree/bindings/sound/samsung,abox-core.txt
```
Core of ABOX IP

This device is an audio subsystem of Exynos AP

Required properties:

- compatible : "samsung,abox-core".

- reg : address for GPR and status

- reg-names : "gpr".

- samsung,id : ID of the core.

- samsung,type : Type of the core. "CA32", "CA7".

- samsung,pmu_power : SFR offset and mask to control power.

Optional properties:

- samsung,pmu_standby : SFR offset and mask to check standby.
  one of pmu_standy and sys_standby should be declared.

- samsung,sys_standby : SFR offset and mask to check standby.
  one of pmu_standy and sys_standby should be declared.

- abox_firmware_sram0 : SRAM firmware.

  - samsung,name : name of the firmware.

  - samsung,area : download area of the firmware. 0 for SRAM, 1 for DRAM.

  - samsung,offset : offset of the download address.

  - samsung,fw-signed : delare it if the firmware is signed.

  - samsung,fw-id : ID of the firmware.

- abox_firmware_dram0 : DRAM firmware

  - samsung,name : name of the firmware.

  - samsung,area : download area of the firmware. 0 for SRAM, 1 for DRAM.

  - samsung,offset : offset of the download address.

  - samsung,fw-signed : delare it if the firmware is signed.

  - samsung,fw-id : ID of the firmware.
```

## Documentation/devicetree/bindings/sound/samsung,abox-debug.txt
```
Debug driver of ABOX IP

This device is an audio subsystem of Exynos AP

Required properties:

- compatible : "samsung,abox-debug".

- memory-region : phandles to reserved memory for debug and silent log.

- reg : <0x0 0x0 0x0>.

Optional properties: no optional property.
```

## Documentation/devicetree/bindings/sound/samsung,abox-dma.txt
```
DMA of ABOX IP

This device is an audio subsystem of Exynos AP

Required properties:

- compatible : "samsung,abox-ddma", "samsung,abox-dual", "samsung,abox-udma-rd",
  "samsung,abox-udma-wr", "samsung,abox-udma-wr-dual", "samsung,abox-udma-wr-debug".

- reg : address of SFR.

- reg-names : "sfr".

- samsung,id : id of the DMA.

- samsung,buffer_type : type of the DMA buffer. "dma", "ion", "ram".

- #sound-dai-cells : 0

- sound-name-prefix : prefix of the DMA. It should start with "ABOX"

Optional properties: no optional property.
```

## Documentation/devicetree/bindings/sound/samsung,abox-effect.txt
```
Effect driver of ABOX IP

This device is an audio subsystem of Exynos AP

Required properties:

- compatible : "samsung,abox-effect"

- reg : address for I/O.

- reg-names : "reg".

Optional properties: no optional property.
```

## Documentation/devicetree/bindings/sound/samsung,abox-gic.txt
```
GIC of ABOX IP

This device is an audio subsystem of Exynos AP

Required properties:

- compatible : "samsung,abox-gic"

- reg : address of GICD and GICC.

- reg-names : "gicd", "gicc".

- interrupts : phandle to parent GIC interrupt ID.

Optional properties: no optional property.
```

## Documentation/devicetree/bindings/sound/samsung,abox-if.txt
```
UAIF of ABOX IP

This device is an audio subsystem of Exynos AP

Required properties:

- compatible : "samsung,abox-uaif", "samsung,abox-dsif", "samsung,abox-spdy"

- reg : address of SFR.

- reg-names : "sfr".

- samsung,id : id of the DMA.

- clocks : phandle to bclk, gate of bclk, mux clk.

- clock-names : "bclk", "bclk_gate", "mux".

- pinctrl-names : "active", "idle".

- pinctrl-0 : phandle to pinctrl for active state.

- pinctrl-1 : phandle to pinctrl for idle state.

- #sound-dai-cells : 0

- sound-name-prefix : "ABOX UAIF0", "ABOX UAIF1", .......

Optional properties: no optional property.
```

## Documentation/devicetree/bindings/sound/samsung,abox-pci.txt
```
PCIE stub of ABOX IP

This device is an audio subsystem of Exynos AP

Required properties:

- compatible : "samsung,abox-pci"

- memory-region = phandle to reserved memory for PCIE

- reg : <0x0 0x0 0x0>.

- pinctrl-names : "pci_on", "sleep"

- pinctrl-0 : phandle to pinctrl for pci on

- pinctrl-1 : phandle to pinctrl for pci off

- s2mpu_mailbox : address of mailbox

Optional properties: no optional property.
```

## Documentation/devicetree/bindings/sound/samsung,abox-tplg.txt
```
Topology parser of ABOX IP

This device is an audio subsystem of Exynos AP

Required properties:

- compatible : "samsung,abox-tplg"

- reg : <0x0 0x0 0x0>.

- sound-name-prefix : "ABOX".

Optional properties: no optional property.
```

## Documentation/devicetree/bindings/sound/samsung,abox-vss.txt
```
VSS of ABOX IP

This device is an audio subsytem of Exynos AP

Required properties:

- compatible : "samsung,abox-vss"

- samsung,magic-offset : magic offset address

- reg : <0x0 0x0 0x0>.

Optional properties: no optional property.
```

## Documentation/devicetree/bindings/sound/samsung,abox-wdma.txt
```
WDMA of ABOX IP

This device is an audio subsystem of Exynos AP

Required properties:

- compatible : "samsung,abox-wdma"

- reg : address of SFR.

- reg-names : "sfr".

- samsung,id : id of the DMA.

- samsung,type : type of the DMA. "normal", "call", "compress", "realtime", "vi-sensing", "sync".

- samsung,buffer_type : type of the DMA buffer. "dma", "ion", "ram".

- #sound-dai-cells : 1

- sound-name-prefix : "ABOX WDMA0", "ABOX WDMA1", .......

Optional properties: no optional property.
```

## Documentation/devicetree/bindings/sound/samsung,abox.txt
```
ABOX IP

This device is an audio subsystem of Exynos AP

Required properties:

- compatible : "samsung,abox".

- reg : address and size of the io resources

- reg-names : "sfr", "sysreg", "sram", "timer", "mailbox_apm"

- #address-cells : <2>

- #size-cells : <1>

- ranges

- iommus : phandle to iommu device

- memory-region : phandle to reserved memory 

- samsung,iommu-group : phandle to iommu group

- power-domains : phandle to power domain

- clocks : phandle to clocks

- clock-names : "pll", "pll1", "audif", "bus", "cnt", "sclk", "cp_pcmc", "aud_pcmc"

- #sound-dai-cells : <1>

- sound-name-prefix : "ABOX"

- samsung,ipc-tx-area : offset and size of IPC TX area

- samsung,ipc-rx-area : offset and size of IPC RX area

- samsung,shm-area : offset and size of shared area

- samsung,handshake-area : offset and size of handshake area

- samsung,abox-gic : phandle to abox_gic device

- samsung,uaif-max-div : maximum divider value of uaif clock

- samsung,atune-count : number of ATUNE in SPUS and SPUM each

- samsung,pm-qos-aud : DVFS level of AUD

- samsung,pm-qos-stable-min : minimum level for stable operation

- samsung,sys_acp_con : ACP controlling SFR address and value

- samsung,abox-llc-way : number of LLC way in each scenario

Optional properties:

- samsung,quirks : "try to asrc off", "silent reset"
```

## Documentation/devicetree/bindings/sound/samsung,exynos-sound.txt
```
Sound card of Exynos

This device is a sound card of Exynos AP

Required properties:

- compatible : "samsung,exynos-sound".

- clock-names : "xclkout"

- clocks : phandle to clock

- MICBIAS1-supply : phandle to regulator for micbias1

- MICBIAS2-supply : phandle to regulator for micbias2

- MICBIAS3-supply : phandle to regulator for micbias3

- samsung,routing : routing for current machine

- samsung,codec : phandle to codec devices

- samsung,prefix : prefix for the codec devices

- samsung,aux : phandle to sound devices but not in the DAI link definitions

- rdma0, rdma1, ... : DAI link definitions.

Optional properties: no optional property.
```
